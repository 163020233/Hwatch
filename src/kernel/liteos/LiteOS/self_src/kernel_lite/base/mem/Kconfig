## src/kernel/liteos/LiteOS/self_src/kernel_lite/base/mem/Kconfig
```kconfig
menu "Memory Management"

config LOSCFG_KERNEL_MEM_ALLOC
    bool "Dynamic Memory Management"
    default y

if LOSCFG_KERNEL_MEM_ALLOC
choice
    prompt "Dynamic Memory Management Algorithm"
    default LOSCFG_KERNEL_MEM_BESTFIT

config LOSCFG_KERNEL_MEM_BESTFIT
    bool "bestfit"
    help
      This option will change mem type as bestfit

config LOSCFG_KERNEL_MEM_BESTFIT_LITTLE
    bool "bestfit_little"
    help
      This option will change mem type as bestfit little
endchoice

config LOSCFG_KERNEL_MEM_SLAB_EXTENTION
    bool "Enable Mem SLAB Extension"
    default n
    depends on LOSCFG_KERNEL_MEM_ALLOC

config LOSCFG_KERNEL_MEM_SLAB_AUTO_EXPANSION_MODE
    bool "Enable Mem SLAB Auto Expansion Mode"
    default n
    depends on LOSCFG_KERNEL_MEM_SLAB_EXTENTION

config LOSCFG_MEM_TASK_STAT
    bool "Enable Memory Task Usage Statistics"
    default y
    depends on LOSCFG_KERNEL_MEM_ALLOC
    help
      Answer Y to enable LiteOS support memory task statistics

config LOSCFG_MEM_DFX_SHOW_CALLER_RA
    bool "Enable Show where MemAlloc function is called"
    default n
    depends on LOSCFG_MEM_TASK_STAT
    help
      Answer Y to enable showing where MemAlloc and MemFree function is called
      Help detect memory leaks and memory double free

config LOSCFG_MEMFRAG_DFX_SHOW_INFO
    bool "Enable Show where MEMFRAG function is called"
    default n
    help
      Answer Y to enable Print memory fragmentation information

config LOSCFG_MEM_DFX_DOUBLE_FREE_CHECK
    bool "Enable check mem double free check by record function called address"
    default n
    depends on LOSCFG_KERNEL_MEM_ALLOC
    help
      Answer Y to enable showing where MemFree function is called
      Help detect memory double free

config LOSCFG_MEM_MUL_MODULE
    bool "Enable Memory module statistics"
    default n
    depends on LOSCFG_KERNEL_MEM_BESTFIT
    help
      Answer Y to enable LiteOS support memory statistics depend on different module

config LOSCFG_MEM_MODULE_MAX
    int "Max Memory Module Number"
    default 32
    range 8 1024
    depends on LOSCFG_MEM_MUL_MODULE
    help
      This represents the maximum number of Memory Module

config LOSCFG_MEM_MUL_POOL
    bool "Enable Memory multi-pool control"
    default n
    depends on LOSCFG_KERNEL_MEM_BESTFIT || LOSCFG_KERNEL_MEM_BESTFIT_LITTLE
    help
      Answer Y to enable LiteOS support memory multi-pool control

config LOSCFG_MAX_POOL_NUM
    int "Maximum Number of Memory Pools"
    default 8
    range 2 32
    help
      The free command can display the number of memory pools

config LOSCFG_MEM_MUL_POOL_ALLOC
      bool "Enable Memory multi-pool alloc"
      default n
      depends on LOSCFG_MEM_MUL_POOL && LOSCFG_KERNEL_MEM_BESTFIT && !LOSCFG_EXC_INTERACTION
      help
        Answer Y to enable LiteOS support memory multi-pool alloc
endif

config LOSCFG_KERNEL_MEMBOX
    bool "Membox Management"
    default y

choice
    prompt "Membox Management Algorithm"
    default LOSCFG_KERNEL_MEMBOX_STATIC
    depends on LOSCFG_KERNEL_MEMBOX

config LOSCFG_KERNEL_MEMBOX_STATIC
    bool "static memory"
    help
      This option will change membox implemented with input memory

config LOSCFG_KERNEL_MEMBOX_DYNAMIC
    bool "dynamic memory"
    depends on LOSCFG_KERNEL_MEM_ALLOC
    help
      This option will change membox implemented with dynamic allocated memory

endchoice

endmenu
```

## src/kernel/liteos/LiteOS/self_src/kernel_lite/extended/lms/Kconfig
```kconfig
config LOSCFG_KERNEL_LMS
    bool "Enable Lite Memory Sanitizer"
    default n
    help
      Select y to build LiteOS with memory sanitizer.

config LOSCFG_LMS_MAX_RECORD_POOL_NUM
    int "Lms check pool max num"
    default 10
    depends on LOSCFG_KERNEL_LMS
    help
      The Max num of lms check pool

config LOSCFG_LMS_LOAD_CHECK
    bool "Enable lms read check"
    default y
    depends on LOSCFG_KERNEL_LMS
    help
      Select y to enable read check.

config LOSCFG_LMS_STORE_CHECK
    bool "Enable lms write check"
    default y
    depends on LOSCFG_KERNEL_LMS
    help
      Select y to enable write check.

config LOSCFG_LMS_CHECK_STRICT
    bool "Enable lms strict check, byte-by-byte"
    default n
    depends on LOSCFG_KERNEL_LMS
    help
      Select y to enable byte-by-byte check in lms

config LOSCFG_LMS_LIBC_HIGH_FREQ_FUNC_CHECK
   bool "Enable libc high frequency function check"
   default y
   depends on LOSCFG_LIB_LIBC && (LOSCFG_LMS_LOAD_CHECK || LOSCFG_LMS_STORE_CHECK)
   help
     Checks the memory when libc frequently-memory-accessed functions are called,
     including memset, memcpy, memmove, strcat, strcpy, strncat and strncpy.
     At least one of LOSCFG_LMS_LOAD_CHECK and LOSCFG_LMS_STORE_CHECK must be enabled.

config LOSCFG_LMS_LIBC_FULL_CHECK
   bool "Enable libc all function do lms check"
   default n
   depends on LOSCFG_LMS_LIBC_HIGH_FREQ_FUNC_CHECK
   help
     Select y to enable libc full check
```

## src/kernel/liteos/LiteOS/self_src/lib/Kconfig
```kconfig
menu "Lib"

config LOSCFG_LIB_LIBSEC
    bool "Enable LibSec"
    default y
    help
      Answer Y to enable LiteOS support secure c.

config LOSCFG_LIB_LIBC
    bool "Enable Libc"
    default y
    depends on !LOSCFG_ARCH_XTENSA
    help
      Answer Y to enable LiteOS support libc.

config LOSCFG_LIB_LIBC_MEM_POOL
      bool "Enable libc independent memory pool"
      default n
      depends on LOSCFG_LIB_LIBC
      help
        Answer Y to enable LiteOS support memory multi-pool alloc separate

config LOSCFG_LIB_LIBC_COMPAT_WIDTH64
    bool "libc 64-bit compatibility"
    default n
    depends on LOSCFG_LIB_LIBC

menuconfig LOSCFG_COMPAT_POSIX
    bool "Enable Posix"
    default y
    depends on LOSCFG_LIB_LIBC
    select LOSCFG_TASK_JOINABLE
    select LOSCFG_KERNEL_MEM_ALLOC
    select LOSCFG_BASE_IPC_MUX
    select LOSCFG_BASE_IPC_SEM
    select LOSCFG_BASE_IPC_EVENT
    select LOSCFG_BASE_CORE_SWTMR
    select LOSCFG_BASE_IPC_QUEUE
    select LOSCFG_QUEUE_DYNAMIC_ALLOCATION
    select LOSCFG_TASK_STACK_DYNAMIC_ALLOCATION
    help
      Answer Y to enable LiteOS support posix interface.

config LOSCFG_COMPAT_POSIX_MQUEUE
    bool "Enable Posix Mqueue"
    default n
    depends on LOSCFG_BOX && LOSCFG_COMPAT_POSIX

if LOSCFG_COMPAT_POSIX_MQUEUE
config LOSCFG_BASE_IPC_MQUEUE_LIMIT
    int "Max MQueue Number In Kernel"
    default 0
    depends on LOSCFG_COMPAT_POSIX_MQUEUE
    help
      This represents the maximum number of message queue in OS kernel, instead of box.

config LOSCFG_BASE_IPC_MQUEUE_OPEN_LIMIT
    int "Max MQueue Open Limit In Kernel"
    default 0
    depends on LOSCFG_COMPAT_POSIX_MQUEUE
    help
      This represents the maximum open num of message queue in OS kernel, instead of box.
endif # LOSCFG_COMPAT_POSIX_MQUEUE

config LOSCFG_COMPAT_POSIX_CONDVAR
    bool "Enable Posix CondVar"
    default n
    depends on LOSCFG_BOX && LOSCFG_COMPAT_POSIX
    select LOSCFG_BASE_IPC_CONDVAR

if LOSCFG_COMPAT_POSIX_CONDVAR
config LOSCFG_BASE_IPC_CONDVAR
    bool "Enable Condition Variable"
    default n
    depends on LOSCFG_COMPAT_POSIX_CONDVAR
    select LOSCFG_BASE_IPC_EVENT

config LOSCFG_BASE_IPC_COND_LIMIT
    int "Max CondVar Number In Kernel"
    default 0
    depends on LOSCFG_BASE_IPC_CONDVAR
    help
      This represents the maximum number of condition variable in OS kernel, instead of box.

config LOSCFG_COND_PERM_MODE
    int  "CondVar Permission Managing Mode"
    default 1
    depends on LOSCFG_BASE_IPC_PERM && LOSCFG_BASE_IPC_CONDVAR
    help
      0 for public mode, 1 for private mode and 2 for managing mode.
endif # LOSCFG_COMPAT_POSIX_CONDVAR

config LOSCFG_COMPAT_POSIX_THREAD_LOCALE
    bool "Enable Posix thread private locale"
    default n
    depends on LOSCFG_COMPAT_POSIX

config LOSCFG_COMPAT_POSIX_THREAD_KERNEL_MODE_CALL
    bool "Enable Posix thread kernel mode call"
    default n
    depends on LOSCFG_BOX && LOSCFG_COMPAT_POSIX

config LOSCFG_LIB_VENDORNAME
    string "User-defined nodename for uname"
    default "vendor"
    depends on LOSCFG_COMPAT_POSIX
    help
      Config nodename for uname api, default is "vendor".

config LOSCFG_LIB_LIBM
    bool "Enable Math"
    default y
    depends on LOSCFG_LIB_LIBC
    help
      Answer Y to enable LiteOS support math function.

config LOSCFG_LIB_LIBMAT
    bool "Enable lib matrix"
    default n
    help
      Answer Y to enable LiteOS support matrix operation.

config LOSCFG_LIB_FORMAT
    bool "Enable Format"
    default y
    depends on LOSCFG_LIB_LIBC
    select LOSCFG_LIB_LIBM
    help
      Answer Y to enable LiteOS support format function.

config LOSCFG_LIBC_TRIM_TIME
    bool "Enable trim time"
    default n
    depends on LOSCFG_LIB_LIBC
    help
      Answer Y to enable LiteOS support trim time.
 
config LOSCFG_LIBC_TRIM_LOCALE
    bool "Enable trim src locale"
    default n
    depends on LOSCFG_LIB_LIBC
    help
      Answer Y to enable LiteOS support trim LOCALE.

config LOSCFG_LIB_STDIO
    bool "Enable Stdio"
    default y
    depends on LOSCFG_LIB_LIBC && LOSCFG_FS_VFS
    select LOSCFG_LIB_FORMAT
    select LOSCFG_COMPAT_POSIX
    select LOSCFG_LIB_LIBM
    help
      Answer Y to enable LiteOS support I/O function.

config LOSCFG_LIBC_TRIM_REMOVE
    bool "Enable remove"
    default n
    depends on LOSCFG_LIB_STDIO
    help
      Answer Y to enable LiteOS support trim remove.

config LOSCFG_SUPPORT_LONG_DOUBLE
    bool "Support Long Double Float Type"
    default y
    depends on LOSCFG_LIB_STDIO || LOSCFG_LIB_LIBM || LOSCFG_COMPAT_POSIX || LOSCFG_LIB_FORMAT
    help
      Answer Y to enable LiteOS support long double float type.

config LOSCFG_LIB_ZLIB
    bool "Enable Zlib"
    default y
    depends on !LOSCFG_ARCH_XTENSA
    select LOSCFG_LIB_LIBC
    select LOSCFG_LIB_LIBM
    help
      Answer Y to enable LiteOS support compress file library.

endmenu
```
