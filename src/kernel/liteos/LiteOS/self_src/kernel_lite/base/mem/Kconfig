## src/kernel/liteos/LiteOS/self_src/targets/Kconfig.shc
```kconfig
config LOSCFG_PLATFORM
    string
    default "hi5601_mcu"      if LOSCFG_PLATFORM_HI5601_MCU
    default "hiex"            if LOSCFG_PLATFORM_HIEX || LOSCFG_PLATFORM_HIEX_ES || LOSCFG_PLATFORM_HIEX_NES
    default "suqin_app"       if LOSCFG_PLATFORM_SUQIN_APP
    default "hi1162_app"      if LOSCFG_PLATFORM_HI1162_APP
    default "sushik_app"      if LOSCFG_PLATFORM_SUSHIK_APP
    default "bs21"            if LOSCFG_PLATFORM_BS21
    default "hi1a71"          if LOSCFG_PLATFORM_HI1A71
    default "hi2131"          if LOSCFG_PLATFORM_HI2131
    default "sw21_app"        if LOSCFG_PLATFORM_SW21_APP
    default "hi3372_app"      if LOSCFG_PLATFORM_HI3372_APP
    default "sw21_app_se"     if LOSCFG_PLATFORM_SW21_APP_SE
    default "sw22_app"        if LOSCFG_PLATFORM_SW22_APP
    default "sw22_app_se"     if LOSCFG_PLATFORM_SW22_APP_SE
    default "sw22_gnss"       if LOSCFG_PLATFORM_SW22_GNSS
    default "sw22_sensor"     if LOSCFG_PLATFORM_SW22_SENSOR
    default "mp18_bgle"       if LOSCFG_PLATFORM_MP18_BGLE
    default "mp18_gnss"       if LOSCFG_PLATFORM_MP18_GNSS
    default "tg8_bgle"        if LOSCFG_PLATFORM_TG8_BGLE
    default "hi2132_app"       if LOSCFG_PLATFORM_HI2132_APP
    default "hi2132_ccore"       if LOSCFG_PLATFORM_HI2132_CCORE
    default "hi1a72_app"      if LOSCFG_PLATFORM_HI1A72_APP
    default "hi1a71e_app"      if LOSCFG_PLATFORM_HI1A71E_APP

choice
    prompt "Board"
    depends on LOSCFG_FAMILY_SHC
    default LOSCFG_PLATFORM_HI5601_MCU

config LOSCFG_PLATFORM_HI5601_MCU
    bool "hi5601_mcu"
    select LOSCFG_ARCH_LINXCORE_131
    select LOSCFG_TIMER_VENDOR
    select LOSCFG_DRIVERS_UART_VENDOR
    select LOSCFG_USING_BOARD_LD

config LOSCFG_PLATFORM_HIEX
    bool "hiex"
    select LOSCFG_ARCH_CORTEX_M55
    select LOSCFG_CORTEX_M_SYSTICK
    select LOSCFG_USING_BOARD_LD
    select LOSCFG_SCHED_LATENCY
    select LOSCFG_DRIVERS_UART_VENDOR

config LOSCFG_PLATFORM_HIEX_NES
    bool "hiex_nes"
    select LOSCFG_ARCH_CORTEX_M55
    select LOSCFG_CORTEX_M_SYSTICK
    select LOSCFG_USING_BOARD_LD
    select LOSCFG_SCHED_LATENCY
    select LOSCFG_DRIVERS_UART_VENDOR

config LOSCFG_PLATFORM_HIEX_ES
    bool "hiex_es"
    select LOSCFG_ARCH_CORTEX_M55
    select LOSCFG_USING_BOARD_LD
    select LOSCFG_SECURE_REGION
    select LOSCFG_TIMER_VENDOR
    select LOSCFG_INTERRUPT_VENDOR
    select LOSCFG_DRIVERS_UART_VENDOR

config LOSCFG_PLATFORM_SUQIN_APP
    bool "suqin_app"
    select LOSCFG_ARCH_LINXCORE_170
    select LOSCFG_ARCH_RISCV_ISA_F
    select LOSCFG_LCMP_CUSTOM_INST16_EXTENSIONS
    select LOSCFG_LCMP_CUSTOM_INST16_SUB_EXTENSIONS
    select LOSCFG_LCMP_CUSTOM_INST32_EXTENSIONS
    select LOSCFG_TIMER_VENDOR
    select LOSCFG_DRIVERS_UART_VENDOR
    select LOSCFG_USING_BOARD_LD
    select LOSCFG_USING_BOARD_RESET_VECTOR

config LOSCFG_PLATFORM_HI1162_APP
    bool "hi1162_app"
    select LOSCFG_ARCH_RISCV_ISA_F
    select LOSCFG_ARCH_LINXCORE_131
    select LOSCFG_TIMER_VENDOR
    select LOSCFG_DRIVERS_UART_VENDOR
    select LOSCFG_USING_BOARD_LD
    select LOSCFG_USING_BOARD_RESET_VECTOR

config LOSCFG_PLATFORM_SUSHIK_APP
    bool "sushik_app"
    select LOSCFG_ARCH_CORTEX_M7
    select LOSCFG_CORTEX_M_NVIC
    select LOSCFG_TIMER_VENDOR
    select LOSCFG_DRIVERS_UART_VENDOR
    select LOSCFG_USING_BOARD_LD

config LOSCFG_PLATFORM_BS21
    bool "bs21"
    select LOSCFG_ARCH_RISCV_ISA_F
    select LOSCFG_ARCH_LINXCORE_131
    select LOSCFG_TIMER_VENDOR
    select LOSCFG_DRIVERS_UART_VENDOR
    select LOSCFG_USING_BOARD_LD
    select LOSCFG_USING_BOARD_RESET_VECTOR
    select LOSCFG_DRIVERS_USB_DEVICE_NO_DRIVER_BASE

config LOSCFG_PLATFORM_HI1A71
    bool "hi1a71"
    select LOSCFG_ARCH_LINGLONG
    select LOSCFG_USING_BOARD_LD
    select LOSCFG_LINGLONG_IC
    select LOSCFG_DRIVERS_UART_VENDOR
    select LOSCFG_TIMER_VENDOR

config LOSCFG_PLATFORM_HI2131
    bool "hi2131"
    select LOSCFG_ARCH_LINXCORE_132_CONFIG30
    select LOSCFG_TIMER_VENDOR
    select LOSCFG_DRIVERS_UART_VENDOR
    select LOSCFG_USING_BOARD_LD
    select LOSCFG_USING_BOARD_RESET_VECTOR

config LOSCFG_PLATFORM_SW21_APP
    bool "sw21_app"
    select LOSCFG_ARCH_LINXCORE_170_CONFIG60
    select LOSCFG_LCMP_CUSTOM_INST16_SUB_EXTENSIONS
    select LOSCFG_TIMER_VENDOR
    select LOSCFG_DRIVERS_UART_VENDOR
    select LOSCFG_USING_BOARD_LD
    select LOSCFG_USING_BOARD_RESET_VECTOR
    select LOSCFG_FS_EXC_OPERATION

config LOSCFG_PLATFORM_HI3372_APP
    bool "hi3372_app"
    select LOSCFG_ARCH_RISCV_ISA_B0p92
    select LOSCFG_ARCH_LINXCORE_170
    select LOSCFG_ARCH_RISCV_ISA_F
    select LOSCFG_LCMP_CUSTOM_INST16_EXTENSIONS
    select LOSCFG_LCMP_CUSTOM_INST16_SUB_EXTENSIONS
    select LOSCFG_LCMP_CUSTOM_INST32_EXTENSIONS
    select LOSCFG_ARCH_RISCV_EPMP
    select LOSCFG_TIMER_VENDOR
    select LOSCFG_DRIVERS_UART_VENDOR
    select LOSCFG_USING_BOARD_LD
    select LOSCFG_USING_BOARD_RESET_VECTOR

config LOSCFG_PLATFORM_SW21_APP_SE
    bool "sw21_app_se"
    select LOSCFG_ARCH_LINXCORE_170_CONFIG60
    select LOSCFG_TIMER_VENDOR
    select LOSCFG_DRIVERS_UART_VENDOR
    select LOSCFG_USING_BOARD_LD
    select LOSCFG_USING_BOARD_RESET_VECTOR
    select LOSCFG_ARCH_PMU
    select LOSCFG_SAFETY_KERNEL
    select LOSCFG_COMPILE_LIB_WITHOUT_OBJ
    select LOSCFG_FS_EXC_OPERATION

config LOSCFG_PLATFORM_SW22_APP
    bool "sw22_app"
    select LOSCFG_ARCH_LINXCORE_170_CONFIG60
    select LOSCFG_LCMP_CUSTOM_INST16_SUB_EXTENSIONS
    select LOSCFG_TIMER_VENDOR
    select LOSCFG_DRIVERS_UART_VENDOR
    select LOSCFG_USING_BOARD_LD
    select LOSCFG_USING_BOARD_RESET_VECTOR
    select LOSCFG_FS_EXC_OPERATION

config LOSCFG_PLATFORM_SW22_APP_SE
    bool "sw22_app_se"
    select LOSCFG_ARCH_LINXCORE_170_CONFIG60
    select LOSCFG_TIMER_VENDOR
    select LOSCFG_DRIVERS_UART_VENDOR
    select LOSCFG_USING_BOARD_LD
    select LOSCFG_USING_BOARD_RESET_VECTOR
    select LOSCFG_ARCH_PMU
    select LOSCFG_SAFETY_KERNEL
    select LOSCFG_COMPILE_LIB_WITHOUT_OBJ
    select LOSCFG_FS_EXC_OPERATION

config LOSCFG_PLATFORM_SW22_GNSS
    bool "sw22_gnss"
    select LOSCFG_ARCH_LINXCORE_170
    select LOSCFG_ARCH_RISCV_ISA_F
    select LOSCFG_LCMP_CUSTOM_INST16_EXTENSIONS
    select LOSCFG_LCMP_CUSTOM_INST16_SUB_EXTENSIONS
    select LOSCFG_LCMP_CUSTOM_INST32_EXTENSIONS
    select LOSCFG_TIMER_VENDOR
    select LOSCFG_DRIVERS_UART_VENDOR
    select LOSCFG_USING_BOARD_LD
    select LOSCFG_USING_BOARD_RESET_VECTOR

config LOSCFG_PLATFORM_MP18_BGLE
    bool "mp18_bgle"
    select LOSCFG_ARCH_LINXCORE_170
    select LOSCFG_TIMER_VENDOR
    select LOSCFG_DRIVERS_UART_VENDOR
    select LOSCFG_USING_BOARD_LD
    select LOSCFG_USING_BOARD_RESET_VECTOR
    select LOSCFG_LCMP_CUSTOM_INST16_EXTENSIONS
    select LOSCFG_LCMP_CUSTOM_INST32_EXTENSIONS
    select LOSCFG_ARCH_RISCV_ISA_B0p92

config LOSCFG_PLATFORM_MP18_GNSS
    bool "mp18_gnss"
    select LOSCFG_ARCH_LINXCORE_170
    select LOSCFG_ARCH_RISCV_ISA_D
    select LOSCFG_TIMER_VENDOR
    select LOSCFG_DRIVERS_UART_VENDOR
    select LOSCFG_USING_BOARD_LD
    select LOSCFG_USING_BOARD_RESET_VECTOR
    select LOSCFG_LCMP_CUSTOM_INST16_EXTENSIONS
    select LOSCFG_LCMP_CUSTOM_INST32_EXTENSIONS
    select LOSCFG_ARCH_RISCV_ISA_B0p92

config LOSCFG_PLATFORM_HI2132_APP
    bool "hi2132_app"
    select LOSCFG_ARCH_LINXCORE_300S_CONFIG41
    select LOSCFG_TIMER_VENDOR
    select LOSCFG_DRIVERS_UART_VENDOR
    select LOSCFG_USING_BOARD_LD
    select LOSCFG_USING_BOARD_RESET_VECTOR

config LOSCFG_PLATFORM_HI2132_CCORE
    bool "hi2132_ccore"
    select LOSCFG_ARCH_LINXCORE_300S_CONFIG16
    select LOSCFG_TIMER_VENDOR
    select LOSCFG_DRIVERS_UART_VENDOR
    select LOSCFG_USING_BOARD_LD
    select LOSCFG_USING_BOARD_RESET_VECTOR

config LOSCFG_PLATFORM_HI1A72_APP
    bool "hi1a72_app"
    select LOSCFG_ARCH_LINXCORE_170
    select LOSCFG_ARCH_RISCV_RV32F
    select LOSCFG_LCMP_CUSTOM_INST16_EXTENSIONS
    select LOSCFG_LCMP_CUSTOM_INST16_SUB_EXTENSIONS
    select LOSCFG_LCMP_CUSTOM_INST32_EXTENSIONS
    select LOSCFG_TIMER_VENDOR
    select LOSCFG_DRIVERS_UART_VENDOR
    select LOSCFG_USING_BOARD_LD
    select LOSCFG_USING_BOARD_RESET_VECTOR
    select LOSCFG_ARCH_RISCV_ISA_B0p92
    select LOSCFG_ARCH_RISCV_ISA_F
    select LOSCFG_ARCH_RISCV_EPMP

config LOSCFG_PLATFORM_HI1A71E_APP
    bool "hi1a71e_app"
    select LOSCFG_ARCH_LINXCORE_170
    select LOSCFG_ARCH_RISCV_RV32F
    select LOSCFG_LCMP_CUSTOM_INST16_EXTENSIONS
    select LOSCFG_LCMP_CUSTOM_INST16_SUB_EXTENSIONS
    select LOSCFG_LCMP_CUSTOM_INST32_EXTENSIONS
    select LOSCFG_TIMER_VENDOR
    select LOSCFG_DRIVERS_UART_VENDOR
    select LOSCFG_USING_BOARD_LD
    select LOSCFG_USING_BOARD_RESET_VECTOR
    select LOSCFG_ARCH_RISCV_ISA_B0p92
    select LOSCFG_ARCH_RISCV_ISA_F
    select LOSCFG_ARCH_RISCV_EPMP

config LOSCFG_PLATFORM_TG8_BGLE
    bool "tg8_bgle"
    select LOSCFG_ARCH_LINXCORE_170
    select LOSCFG_TIMER_VENDOR
    select LOSCFG_DRIVERS_UART_VENDOR
    select LOSCFG_USING_BOARD_LD
    select LOSCFG_USING_BOARD_RESET_VECTOR
    select LOSCFG_LCMP_CUSTOM_INST16_EXTENSIONS
    select LOSCFG_LCMP_CUSTOM_INST32_EXTENSIONS
    select LOSCFG_ARCH_RISCV_ISA_B0p92
endchoice
```

## src/kernel/liteos/LiteOS/self_src/targets/Kconfig.smc
```kconfig
config LOSCFG_PLATFORM
    string
    default "hi3161"          if LOSCFG_PLATFORM_HI3161
    default "himotrix"        if LOSCFG_PLATFORM_himotrix

config LOSCFG_UART1_SERIAL_SUPPORT
    bool "uart1_serial_out"
    default n
    depends on LOSCFG_FAMILY_SMC
    help
        Answer Y to set serial output fom uart1, otherwise serial output from uart0.

config TEST_LITEOS_START_TIMER
    bool "test LiteOS start time"
    depends on LOSCFG_FAMILY_SMC
    default n
    help
        Answer Y to test LiteOS start time.

choice
    prompt "Board"
    depends on LOSCFG_FAMILY_SMC
    default LOSCFG_PLATFORM_HI3161

config LOSCFG_PLATFORM_HI3161
    bool "hi3161"
    select LOSCFG_PLATFORM_HISI_RISCV
    select LOSCFG_ARCH_RISCV_RV32F
    select LOSCFG_USING_BOARD_LD
    select LOSCFG_DRIVERS_UART_LITEOS
    select LOSCFG_USING_BOARD_RESET_VECTOR

config LOSCFG_PLATFORM_himotrix
    bool "himotrix"
    select LOSCFG_PLATFORM_HISI_RISCV
    select LOSCFG_ARCH_RISCV_RV32F
    select LOSCFG_USING_BOARD_LD
    select LOSCFG_DRIVERS_UART_LITEOS
    select LOSCFG_USING_BOARD_RESET_VECTOR

endchoice
```

## src/kernel/liteos/LiteOS/self_src/targets/Kconfig.test
```kconfig
config LOSCFG_PLATFORM
    string
    default "hiwing"          if LOSCFG_PLATFORM_HIWING
choice
    prompt "Board"
    default LOSCFG_PLATFORM_HIWING

config LOSCFG_PLATFORM_HIWING
    bool "hiwing"
    depends on LOSCFG_FAMILY_TEST
    select LOSCFG_PLATFORM_HISI_RISCV
    select LOSCFG_ARCH_RISCV_RV32F
    select LOSCFG_USING_BOARD_LD
    select LOSCFG_DRIVERS_UART_LITEOS

endchoice
```

## src/kernel/non_os/Kconfig
```kconfig
#===============================================================================
# @brief    Kconfig file.
# Copyright (c) HiSilicon (Shanghai) Technologies Co., Ltd. 2025-2025. All rights reserved.
#===============================================================================
config NONOS_SUPPORT_TIMER
    bool
    prompt "nonos support timer"
    default n
    depends on DRIVER_SUPPORT_TIMER

config NONOS_SUPPORT_TIMER_USING_RTC
    bool
    prompt "nonos support timer using rtc"
    default n
    depends on NONOS_SUPPORT_TIMER

config NONOS_SUPPORT_MSGQUEUE
    bool
    default y
    prompt "nonos support message queue"

config NONOS_MSGQUEUE_LIMIT
    int
    prompt "max number of nonos msgqueue"
    default 1
    depends on NONOS_SUPPORT_MSGQUEUE
config NONOS_MSGQUEUE_MSG_LIMIT
    int
    prompt "maximum number of messages in each msgqueue"
    default 32
    depends on NONOS_SUPPORT_MSGQUEUE
config NONOS_MSGQUEUE_MSG_SIZE_LIMIT
    int
    prompt "maximum data length of a message that msgqueue"
    default 256
    depends on NONOS_SUPPORT_MSGQUEUE
```

## src/kernel/seliteos/Kconfig
```kconfig
#===============================================================================
# @brief    Kconfig file.
# Copyright (c) HiSilicon (Shanghai) Technologies Co., Ltd. 2026-2026. All rights reserved.
#===============================================================================
config PSA_SERVICE_SUPPORT
    bool
    prompt "PSA service support"
    default y
    help
        This option means support PSA service.
    depends on DRIVER_SUPPORT_SELITEOS

if PSA_SERVICE_SUPPORT
menu "psa service"
    osource "kernel/seliteos/kernel/service/psa/Kconfig"
endmenu
endif
```

## src/middleware/chips/Kconfig
```kconfig
#===============================================================================
# @brief    Kconfig file.
# Copyright (c) HiSilicon (Shanghai) Technologies Co., Ltd. 2022-2023. All rights reserved.
#===============================================================================

choice
    prompt "Choose Chip"

config MIDDLEWARE_CHIP_WS53
    bool "ws53"

config MIDDLEWARE_CHIP_WS63
    bool "ws63"

config MIDDLEWARE_CHIP_WS75
    bool "ws75"

config MIDDLEWARE_CHIP_3322
    bool "3322"

config MIDDLEWARE_CHIP_USW
    bool "USW"

endchoice

if MIDDLEWARE_CHIP_WS53
menu "Chip Configurations for ws53"
    comment "Config ws53"
    osource "middleware/chips/ws53/Kconfig"
endmenu
endif

if MIDDLEWARE_CHIP_WS63
menu "Chip Configurations for ws63"
    comment "Config ws63"
    osource "middleware/chips/ws63/Kconfig"
endmenu
endif

if CHIP_WS75
menu "middleware Chip Configurations for ws75"
    comment "ws75 chipset middleware config"
    osource "middleware/chips/ws75/Kconfig"
endmenu
endif

if CHIP_3322
    menu "middleware Chip Configurations for 3322"
        comment "3322 chipset middleware config"
        osource "middleware/chips/3322/Kconfig"
    endmenu
endif

if MIDDLEWARE_CHIP_USW
    menu "middleware Chip Configurations for usw"
        comment "usw chipset middleware config"
        osource "middleware/chips/usw/Kconfig"
    endmenu
endif
```

## src/middleware/services/srv_tiot_host/tiot_driver/common/pm/Kconfig
```kconfig
config PM_WAKEUP_BY_UART
    bool "Wakeup by UART"
    depends on XMIT_WITH_UART

config PM_CHECK_SLEEP_ACK_IN_FALLING_EDGE
    bool
    prompt "Support check sleep ack in the falling edge interrupt of wakein gpio."
    default n

config PM_MANAGE_LOWPOWER
    bool
    prompt "Manage lowpower"
    default y
    help
        This option means support lowpower.
```

## src/middleware/utils/at/Kconfig
```kconfig
#===============================================================================
# @brief    Kconfig file.
# Copyright (c) HiSilicon (Shanghai) Technologies Co., Ltd. 2022-2023. All rights reserved.
#===============================================================================
config AT_SUPPORT_PLT
    bool
    prompt "platform at command"
    default n
    help
        This option means at support plt.

config AT_DEBUG_REGISTER_CCPRIV
    bool
    prompt "ccpriv at debug command"
    default n
    help
        This option means at support ccpriv.

config AT_SUPPORT_CMD_FORWARD
    bool
    prompt "at support send cmd string to other core"
    default n
    help
        This option means at support send cmd to other core.

config AT_CMD_MAX_LENGTH
    int
    prompt "The max length of AT command."
    default 128
    help
        This option means the length of at command.

if AT_SUPPORT_PLT
menu "Config AT CFBB"
    comment "Config AT CFBB"
    osource  "middleware/utils/at/at/Kconfig"
endmenu
endif
```
