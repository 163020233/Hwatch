## src/kernel/liteos/LiteOS/self_src/fs/Kconfig
```kconfig
menu "FileSystem"
orsource "compat/Kconfig"
orsource "vfs/Kconfig"
orsource "fat/Kconfig"
orsource "ramfs/Kconfig"
orsource "romfs/Kconfig"
orsource "yaffs2/os_adapt/adapt_liteos/Kconfig"
orsource "nfs/Kconfig"
orsource "proc/Kconfig"
orsource "littlefs/Kconfig"
endmenu

config LOSCFG_DRIVER_DISK
    bool
    default n
    depends on LOSCFG_FS_VFS
    help
      Answer Y to enable LiteOS support pluggable device manager.
```

## src/kernel/liteos/LiteOS/self_src/fs/compat/Kconfig
```kconfig
config LOSCFG_FS_COMPAT_NUTTX
    bool "Enable Compat Nuttx"
    default n
    depends on LOSCFG_FS_VFS
    help
      Answer Y to enable FS Compat Nuttx interface.
```

## src/kernel/liteos/LiteOS/self_src/fs/fat/Kconfig
```kconfig
config LOSCFG_FS_FAT
    bool "Enable FAT"
    default y
    depends on LOSCFG_FS_VFS
    select LOSCFG_DRIVER_DISK
    help
      Answer Y to enable LiteOS support fat filesystem.

config LOSCFG_FS_FAT_CACHE
    bool "Enable FAT Cache"
    default y
    depends on LOSCFG_FS_FAT
    select LOSCFG_COMPAT_LINUX
    select LOSCFG_COMPAT_LINUX_RBTREE
    help
      Answer Y to enable LiteOS fat filesystem support cache.

config LOSCFG_FS_FAT_BLOCK_NUMS
    int "Fat Cache Block Numbers"
    default 32
    depends on LOSCFG_FS_FAT_CACHE
    help
      This represents Fat cache block numbers configuration.

config LOSCFG_FS_FAT_CACHE_SYNC_THREAD
    bool "Enable FAT Cache Sync Thread"
    default n
    depends on LOSCFG_FS_FAT_CACHE
    help
      Answer Y to enable LiteOS fat filesystem support cache sync thread.

config LOSCFG_FS_FAT_CACHE_PROC
    bool "Enable FAT Cache Proc"
    default y
    depends on LOSCFG_FS_PROC
    depends on LOSCFG_FS_FAT_CACHE
    help
      Answer Y to enable LiteOS fat filesystem support cache proc file.

config LOSCFG_FS_FAT_CACHE_INDEPENDENT_MEMORY_POOL
    bool "Enable FAT Cache Use Independent Memory Pool"
    default n
    depends on LOSCFG_FS_FAT_CACHE
    help
      Answer Y to enable LiteOS fat cache use independent memory pool.

config LOSCFG_FS_FAT_DCACHE
    bool "Enable FAT Dentry Cache"
    default n
    depends on LOSCFG_FS_FAT
    help
      Answer Y to enable LiteOS fat filesystem support dentry cache.

config LOSCFG_FS_FAT_TRIM
    bool "Enable FAT Trim"
    default n
    depends on LOSCFG_FS_FAT && LOSCFG_DRIVERS_MMC
    help
      Answer Y to enable LiteOS fat filesystem support trim.

choice
    depends on LOSCFG_FS_FAT_TRIM
    prompt "FAT Trim"
    default LOSCFG_FS_FAT_UNI_TRIM
    help
      Enable FAT Uni-Trim.
      Enable FAT Direct-Trim.

config LOSCFG_FS_FAT_UNI_TRIM
    bool "Enable FAT Uni-Trim"
    depends on LOSCFG_FS_FAT_TRIM
    help
      Answer Y to enable LiteOS fat filesystem support unite trim.

config LOSCFG_FS_FAT_DIRECT_TRIM
    bool "Enable FAT Direct-Trim"
    depends on LOSCFG_FS_FAT_TRIM
    help
      Answer Y to enable LiteOS fat filesystem support direct trim.

endchoice

config LOSCFG_FS_FAT_CHINESE
    bool "Enable Chinese"
    default y
    depends on LOSCFG_FS_FAT
    help
      Answer Y to enable LiteOS fat filesystem support Chinese.

choice
    depends on LOSCFG_FS_FAT_CHINESE
    prompt "Chinese Encode"
    default LOSCFG_FS_FAT_CHINESE_GB2312

config LOSCFG_FS_FAT_CHINESE_GB2312
    bool "Enable GB2312 Chinese Encode"
    depends on LOSCFG_FS_FAT_CHINESE
    help
      Answer Y to enable Chinese encode with GB2312.

config LOSCFG_FS_FAT_CHINESE_UTF_8
    bool "Enable UTF-8 Chinese Encode"
    depends on LOSCFG_FS_FAT_CHINESE
    help
      Answer Y to enable Chinese encode with UTF-8.
endchoice

config LOSCFG_FS_FAT_VIRTUAL_PARTITION
    bool "Enable Virtual Partition"
    default n
    depends on LOSCFG_FS_FAT

config LOSCFG_FS_FAT_VOLUMES
    int "The max number of volumes that fatfs support"
    depends on LOSCFG_FS_FAT
    default 16

config LOSCFG_FS_FAT_INDEPENDENT_MEMORY_POOL
    bool "Enable FAT Use Independent Memory Pool"
    default n
    depends on LOSCFG_FS_FAT
    help
      Answer Y to enable LiteOS fat use independent memory pool.

config LOSCFG_FS_FAT_WRITE_WITH_SYNC
    bool "Enable FAT Write With Sync Operation"
    default y
    depends on LOSCFG_FS_FAT
    help
      Answer Y to enable LiteOS fat filesystem write with sync which enhance data integrality but degrade performance.

choice
    depends on LOSCFG_FS_FAT
    prompt "LFN Buffer"
    default LOSCFG_FS_FAT_STACK_LFN

config LOSCFG_FS_FAT_STACK_LFN
    bool "Use Stack As LFN Buffer"
    depends on LOSCFG_FS_FAT
    help
      Answer Y to use stack as LFN working buffer

config LOSCFG_FS_FAT_HEAP_LFN
    bool "Use Heap As LFN Buffer"
    depends on LOSCFG_FS_FAT
    help
      Answer Y to use heap as LFN working buffer

  endchoice
```

## src/kernel/liteos/LiteOS/self_src/fs/littlefs/Kconfig
```kconfig
config LOSCFG_FS_LITTLEFS
    bool "Enable LITTLEFS"
    default y
    depends on LOSCFG_FS_VFS && LOSCFG_DRIVERS_MTD_SPI_NOR
    help
      Answer Y to enable LiteOS support littlefs filesystem.
```

## src/kernel/liteos/LiteOS/self_src/fs/proc/Kconfig
```kconfig
config LOSCFG_FS_PROC
    bool "Enable PROC"
    default y
    depends on LOSCFG_FS_VFS
    help
      Answer Y to enable LiteOS support proc filesystem.
```

## src/kernel/liteos/LiteOS/self_src/fs/ramfs/Kconfig
```kconfig
config LOSCFG_FS_RAMFS
    bool "Enable RAMFS"
    default y
    depends on LOSCFG_FS_VFS
    help
      Answer Y to enable LiteOS support ramfs filesystem.
```

## src/kernel/liteos/LiteOS/self_src/fs/romfs/Kconfig
```kconfig
config LOSCFG_FS_ROMFS
    bool "Enable ROMFS"
    default n
    depends on LOSCFG_FS_VFS
    help
      Answer Y to enable LiteOS support romfs filesystem.
```

## src/kernel/liteos/LiteOS/self_src/fs/vfs/Kconfig
```kconfig
config LOSCFG_FS_VFS
    bool "Enable VFS"
    default y
    select LOSCFG_FS_COMPAT_NUTTX
    help
      Answer Y to enable LiteOS support virtual filesystem.

config LOSCFG_FS_EXC_OPERATION
    bool
    default n
    depends on LOSCFG_FS_VFS && LOSCFG_FS_FAT
    help
      Answer Y to enable LiteOS support file or directory operations in exception context.

config LOSCFG_FS_VFS_BLOCK_DEVICE
    bool "Enable Block DEVICE"
    default n
    depends on LOSCFG_FS_VFS
    select LOSCFG_DRIVER_DISK
    help
      Answer Y to enable LiteOS support read/open/seek/write block device.

config LOSCFG_FS_FAT_FTL
    bool "Enable Flash Translation Layer"
    default n
    depends on LOSCFG_DRIVERS_MTD && LOSCFG_FS_VFS
    select LOSCFG_DRIVER_DISK
    select LOSCFG_COMPAT_LINUX_CRC32
    help
      Answer Y to enable LiteOS flash translation layer.

config LOSCFG_FS_FAT_FTL_COMPRESS
    bool "Enable FTL Data Compress"
    default y
    depends on LOSCFG_FS_FAT_FTL
    select LOSCFG_LIB_ZLIB
    help
      Answer Y to enable FTL support data compress on nor flash.

config LOSCFG_FS_VFS_PERM
    bool "Enable VFS Permission"
    depends on LOSCFG_FS_VFS && LOSCFG_SAFETY_KERNEL
    default n
    help
      This option is used to enable vfs permission.
```

## src/kernel/liteos/LiteOS/self_src/fs/yaffs2/os_adapt/adapt_liteos/Kconfig
```kconfig
config LOSCFG_FS_YAFFS
    bool "Enable YAFFS2"
    default y
    depends on LOSCFG_FS_VFS && LOSCFG_DRIVERS_MTD_NAND
    help
      Answer Y to enable LiteOS support yaffs2 filesystem.

config LOSCFG_YAFFS_GC_STACK_SIZE
    int "YAFFS2 gb gc stack size."
    default LOSCFG_BASE_CORE_TSK_DEFAULT_STACK_SIZE
    help
      This is the configuration item for setting the yaffs bg gc stack size.

config LOSCFG_YAFFS_DISABLE_BG_GC_THREAD_FUNC
    bool "Disable BG GC"
    default n
    depends on LOSCFG_FS_YAFFS
    help
      Answer y to disable background scheduled GC functionality.

config LOSCFG_YAFFS_EXTEND_SUPPORT
      bool "Enable Yaffs extend support feature"
      default n
      depends on LOSCFG_FS_YAFFS
      help
        Answer y to enable YAFFS_EXTEND_SUPPORT feature.

#config LOSCFG_FS_YAFFS_CACHE
#   bool "Enable YAFFS2 Cache"
#   default y
#   depends on LOSCFG_FS_YAFFS
#   help
#     Answer y to support for yaffs2 cache.
```
