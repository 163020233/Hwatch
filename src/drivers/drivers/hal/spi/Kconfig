## src/kernel/liteos/LiteOS/self_src/drivers/usb/adapt_liteos/Kconfig
```kconfig
config LOSCFG_DRIVERS_USB
    bool "Enable USB"
    default n
    select LOSCFG_DRIVERS_BASE if !LOSCFG_DRIVERS_USB_DEVICE_NO_DRIVER_BASE
    select LOSCFG_HWI_WITH_ARG
    help
      Answer Y to enable LiteOS support usb.

config LOSCFG_DRIVERS_USB_HOST_DRIVER
    bool "Enable USB HCD"
    default n
    depends on LOSCFG_DRIVERS_USB
    help
      Answer Y to enable LiteOS to support usb host controller driver.

choice
    depends on LOSCFG_DRIVERS_USB_HOST_DRIVER
    prompt "USB HCD"
    default LOSCFG_DRIVERS_USB_HOST_XHCI
    help
      Enable EHCI for USB 2.0.
      Enable XHCI for USB 3.0.

config LOSCFG_DRIVERS_USB_HOST_XHCI
    bool "Enable XHCI HCD (USB 3.0)"
    depends on LOSCFG_DRIVERS_USB

endchoice

menuconfig LOSCFG_DRIVERS_USB_HOST_PARAMS_CONFIG
    bool "USB Host Extra Configuration"
    default n
    depends on LOSCFG_DRIVERS_USB_HOST_DRIVER

if LOSCFG_DRIVERS_USB_HOST_PARAMS_CONFIG
config LOSCFG_DRIVERS_USB_HOST_MAX_DEVICES
    int "USB max device"
    range 3 254
    default 128
    help
      This represents the maxinum devices attached to a usb bus. Root-hub occupies one.

config LOSCFG_DRIVERS_USB_HOST_CONFIG_LEN
    int "USB max length of config descirptor"
    range 8192 65535
    default 65535
    help
      This represents the maxinum length of config descirptor in bytes with a USB device.

config LOSCFG_DRIVERS_USB_HOST_IFACE_MAX
    int "USB max count of interface"
    range 3 32
    default 32
    help
      This represents the max count of interface with a USB device.

config LOSCFG_DRIVERS_USB_HOST_MAX_EP_STREAMS
    int "USB max count of streams for an endpoint"
    range 1 32
    default 32
    help
      This represents the count of streams for an endpoint with a USB device.
endif

if LOSCFG_DRIVERS_USB_HOST_XHCI && LOSCFG_DRIVERS_USB_HOST_PARAMS_CONFIG
menuconfig LOSCFG_DRIVERS_USB_XHCI_CONFIG
    bool "xHCI Extra Configuration"
    default n
    depends on LOSCFG_DRIVERS_USB_HOST_XHCI

if LOSCFG_DRIVERS_USB_XHCI_CONFIG
config LOSCFG_USB_XHCI_MAX_TRANSFERS
    int "USB xHCI max count of transfers"
    range 4 20
    default 10
    help
      This represents the maxinum element count of transfers in xHCI transfer-ring.

config LOSCFG_USB_XHCI_MAX_SCRATCHPADS
    int "USB xHCI max count of scratchpads"
    range 2 256
    default 256
    help
      This represents the maxinum element count of scratchpad for xHC.

config LOSCFG_USB_XHCI_MAX_EVENTS
    int "USB xHCI max count of events"
    range 64 208
    default 208
    help
      This represents the maxinum size of events in xHCI event-ring in bytes. It must be a multiple of 4.

config LOSCFG_USB_XHCI_INTERRUPT_INTERVAL
    int "USB xHCI interrupt interval"
    range 1 40000
    default 500
    help
      This represents the interrupt interval for xHCI, unit is 250ns.
endif
endif

config LOSCFG_DRIVERS_USB_HOST_XHCI_NONCACHE_MEM
    bool "Non-Cache mem use in mem"
    default n
    depends on LOSCFG_DRIVERS_USB_HOST_DRIVER
    help
      Say Y here if usb use non-cache mem.

config LOSCFG_DRIVERS_USB_HOST_XHCI_IOSC_SIA
    bool "Start Isoc ASAP"
    default n
    depends on LOSCFG_DRIVERS_USB_HOST_DRIVER
    help
      Say Y here if use SIA, igonre Frame ID and the Isoc TD is shecduled as soon as possible.

config LOSCFG_DRIVERS_USB_HOST_STANDALONE_MEM_POOL
    bool "Standalone memory pool in usb host mode"
    default n
    depends on LOSCFG_DRIVERS_USB_HOST_DRIVER
    help
      Say Y here to use standalone memory pool when running usb in host mode.

config LOSCFG_DRIVERS_USB_FIFO
    bool
    default n
    depends on LOSCFG_DRIVERS_USB && LOSCFG_DRIVERS_USB_HOST_DRIVER

config LOSCFG_DRIVERS_USB_DEVICE_CLASS_DRIVERS
    bool "Enable USB Device Class Drivers"
    default y
    depends on LOSCFG_DRIVERS_USB && LOSCFG_DRIVERS_USB_HOST_DRIVER
    help
      Answer Y to enable LiteOS to support usb device class drivers.

menu "USB Device Class Drivers"
    depends on LOSCFG_DRIVERS_USB_DEVICE_CLASS_DRIVERS
config LOSCFG_DRIVERS_USB_MASS_STORAGE
    bool "Enable USB Mass Storage Support"
    default n
    depends on LOSCFG_DRIVERS_USB_DEVICE_CLASS_DRIVERS
    select LOSCFG_DRIVER_DISK
    help
      Say Y here if you want to connect USB mass storage devices to your system's USB port.

config LOSCFG_DRIVERS_USB_HOST_UVC_CLASS
    bool "Enable USB Host UVC Support"
    default n
    depends on LOSCFG_DRIVERS_USB_DEVICE_CLASS_DRIVERS
    help
      Say Y here if you want to connect UVC devices to your system's USB port.

config LOSCFG_DRIVERS_USB_HOST_HID
    bool "Enable USB Host HID Support"
    default n
    select LOSCFG_DRIVERS_USB_FIFO
    depends on LOSCFG_DRIVERS_USB_DEVICE_CLASS_DRIVERS
    help
      Say Y here if you want to connect USB HID devices to your system's USB port.

config LOSCFG_DRIVERS_USB_HOST_UAC_CLASS
    bool "Enable USB Host UAC Support"
    default n
    depends on LOSCFG_DRIVERS_USB_DEVICE_CLASS_DRIVERS
    help
      Say Y here if you want to connect UAC devices to your system's USB port.

config LOSCFG_DRIVERS_USB_HOST_NET_CLASS
    bool "Enable USB Host Netcard Support"
    default n
    depends on LOSCFG_DRIVERS_USB_DEVICE_CLASS_DRIVERS
    help
      Say Y here if you want to connect USB Netcard devices to your system's USB port.
      Currently only support ASIX AX8817X and RNDIS Netcard.

config LOSCFG_DRIVERS_USB_NET_ASIX
    bool "Enable USB Host Ethernet for ASIX"
    default n
    depends on LOSCFG_DRIVERS_USB_HOST_NET_CLASS
    help
      Say Y here if you want to connect ASIX AX8817X Netcard devices to your system's USB port.
endmenu

config LOSCFG_DRIVERS_USB_DWC_DRIVER
    bool "Enable USB DWC Controller"
    select LOSCFG_DRIVERS_USB_GADGET
    default y
    depends on LOSCFG_DRIVERS_USB
    help
      Answer Y to enable LiteOS to support device controller driver.

menu "USB DWC Controller Config"
    depends on LOSCFG_DRIVERS_USB_DWC_DRIVER

choice
    depends on LOSCFG_DRIVERS_USB_DWC_DRIVER
    prompt "DWC Controller"
    default LOSCFG_DRIVERS_USB2_DEVICE_CONTROLLER
    help
      This selects the usb(ehci/xhci) family usb device.
      Say Y to enable usb2.0 or usb3.0 controller driver.

config LOSCFG_DRIVERS_USB2_DEVICE_CONTROLLER
    bool "Enable USB2.0 Device Controller"

config LOSCFG_DRIVERS_USB2_PORT_DISCONNECT
    bool "Enable USB Port Disconnect Check"
    default n
    depends on LOSCFG_DRIVERS_USB2_DEVICE_CONTROLLER
    help
      If disconnect interrupt reporting is not supported,
      you can enable this feature to check port disconnect and perform corresponding disconnect operations,
      currently only used to detect usb disconnection status in device uvc mode.

config LOSCFG_DRIVERS_USB2_DWC_ULPI_INTERFANCE
    bool "Enable USB PHY ULPI Interface"
    default n
    depends on LOSCFG_DRIVERS_USB2_DEVICE_CONTROLLER
    help
      If the USB PHY chip is external mounting, enable ULPI.
      If the USB PHY is integrated in the chip, disable ULPI.

config LOSCFG_DRIVERS_USB2_DWC_OTG_DFIFO_DYNAMIC
    bool "Enable Dynamic FIFO Sizing"
    default n
    depends on LOSCFG_DRIVERS_USB2_DEVICE_CONTROLLER
    help
      Requires SOC to specify whether dynamic FIFO sizing is enabled.

#
# Applies to IN and OUT endpoints, this value is in bytes.
# The application must set this field with the maximum packet size for the current logical endpoint.
# If the DfifoDepth value is small, the maximum packet value can be appropriately reduced according
# to the business.
#
menu "USB Endpoints Max Packet Size"
    depends on LOSCFG_DRIVERS_USB2_DWC_OTG_DFIFO_DYNAMIC

config LOSCFG_DRIVERS_USB2_DWC_OUT_EP_MPS
    int "OUT Endpoints Max Packet Size"
    range 64 1024
    default 512

config LOSCFG_DRIVERS_USB2_DWC_IN_EP_INDEX1_MPS
    int "IN Endpoint Index1 Max Packet Size"
    range 64 1024
    default 256
    depends on (LOSCFG_USB_IN_EP_NUM > 0)


config LOSCFG_DRIVERS_USB2_DWC_IN_EP_INDEX2_MPS
    int "IN Endpoint Index2 Max Packet Size"
    range 64 1024
    default 256
    depends on (LOSCFG_USB_IN_EP_NUM > 1)

config LOSCFG_DRIVERS_USB2_DWC_IN_EP_INDEX3_MPS
    int "IN Endpoint Index3 Max Packet Size"
    range 64 1024
    default 256
    depends on (LOSCFG_USB_IN_EP_NUM > 2)

endmenu

config LOSCFG_DRIVERS_USB_DEVICE_CUSTOM_CTRLREQ_BUF_SIZE
    bool "Enable Custom EP0 Ctrlreq Buffer Size"
    default n
    depends on LOSCFG_DRIVERS_USB2_DEVICE_CONTROLLER

config LOSCFG_DRIVERS_USB_DEVICE_CTRLREQ_BUF_SIZE
    int "USB EP0 Ctrlreq Buffer Size"
    default 4096
    depends on LOSCFG_DRIVERS_USB_DEVICE_CUSTOM_CTRLREQ_BUF_SIZE
    help
      This represents the ctrlreq buffer size.
      Protocol loading may fail when the configuration is too small.

config LOSCFG_DRIVERS_USB2_DWC_INCOMPISOIN
    bool "Enable USB Incomplete Isochronous IN Transfer Interrupt"
    default y
    depends on LOSCFG_DRIVERS_USB2_DEVICE_CONTROLLER
    help
      If the USB controller reports an incomplete isochronous in transfer interrupt
      and software needs to handle this interrupt, enable this configuration item.

config LOSCFG_DRIVERS_USB3_DEVICE_CONTROLLER
    bool "Enable USB3.0 Device Controller"

choice
    depends on LOSCFG_DRIVERS_USB3_DEVICE_CONTROLLER
    prompt "USB Mode"
    default LOSCFG_DRIVERS_USB3_DEVICE_USB_MODE_USB_3_0

config LOSCFG_DRIVERS_USB3_DEVICE_USB_MODE_USB_1_1
    bool "USB 1.1"

config LOSCFG_DRIVERS_USB3_DEVICE_USB_MODE_USB_2_0
    bool "USB 2.0"

config LOSCFG_DRIVERS_USB3_DEVICE_USB_MODE_USB_3_0
    bool "USB 3.0"

endchoice

config LOSCFG_USB_PHY_SUSPEND_NOT_SUPPORTED
    bool "Disable USB PHY Suspend"
    depends on LOSCFG_DRIVERS_USB3_DEVICE_CONTROLLER
    help
      Say Y here if you are debugging on the FPGA platform.

config LOSCFG_DWC_USB3_NUM_BULK_TRBS
    int "Number of Bulk Trbs"
    range 1 256
    default 256
    depends on LOSCFG_DRIVERS_USB3_DEVICE_CONTROLLER
    help
      This indicates the number of bulk trbs.

config LOSCFG_DWC_USB3_NUM_ISOC_TRBS
    int "Number of Isoc Trbs"
    range 1 256
    default 256
    depends on LOSCFG_DRIVERS_USB3_DEVICE_CONTROLLER
    help
      This indicates number of isoc trbs.

config LOSCFG_DRIVERS_HiUSBC3X_CONTROLLER
    bool "Enable HiUSBC3X Device Controller"

config LOSCFG_DRIVERS_HIUSBC_FPGA_BOARD
    bool "Enable Hiusbc Controller FPGA"
    default n
    depends on LOSCFG_DRIVERS_HiUSBC3X_CONTROLLER
    help
      If the board is FPGA, enable this configuration item.
      If the board is ASIC, disable this configuration item.

endchoice

menuconfig LOSCFG_DRIVERS_USB_DEVICE_SLAVE_CONFIG
    bool "Slave Core Extra Borard Configuration"
    default n
    depends on LOSCFG_DRIVERS_USB2_DEVICE_CONTROLLER || LOSCFG_DRIVERS_USB3_DEVICE_CONTROLLER

if LOSCFG_DRIVERS_USB_DEVICE_SLAVE_CONFIG

config LOSCFG_USB_OUT_EP_NUM
    int "USB Out Endpoints Number"
    range 1 15
    default 2
    help
      This represents usb out endpoints number.

config LOSCFG_USB_IN_EP_NUM
    int "USB In Endpoints Number"
    range 1 15
    default 4
    help
      This represents usb in endpoints number.

if LOSCFG_DRIVERS_USB3_DEVICE_CONTROLLER

config LOSCFG_USB_GEVENT_BUF_NUM
    int "USB Event Buffer Number"
    default 0
    help
      This represents the device gevent buffer number.

config LOSCFG_USB_DEPCFG_INTR_NUM
    int "USB DEPCFG Interrupt Number"
    default 0
    help
      This represents DEPCFG parameter1 interrupt number.

endif

config LOSCFG_USB_DMA_OFFSET
    string "USB DMA Address Offset"
    default "0x0"
    help
      This represents DMA address offset, the value is decided by hardware design.
endif

endmenu

config LOSCFG_DRIVERS_USB_GADGET
    bool "Enable USB Gadget Support"
    default y
    depends on LOSCFG_DRIVERS_USB && LOSCFG_DRIVERS_USB_DWC_DRIVER
    help
      Answer Y to enable LiteOS to support usb peripheral devices.
      Enable this configuration option if you want to run LiteOS inside a USB peripheral device.

menu "USB Gadget Drivers"
depends on LOSCFG_DRIVERS_USB_GADGET

config LOSCFG_DRIVERS_USB_MASS_STORAGE_GADGET
    bool "Enable USB Mass Storage Gadget"
    depends on LOSCFG_FS_VFS && LOSCFG_COMPAT_LINUX
    select LOSCFG_DRIVER_DISK

config LOSCFG_DRIVERS_USB_MASS_STORAGE_EXT_SER_FUNC
    bool "Enable Extra Serial Function"
    depends on LOSCFG_DRIVERS_USB_MASS_STORAGE_GADGET
    help
      Answer Y to support composite device (mass storage & serial).
      Currently, the maximum number of serial ports is 2.
      If the actual number of endpoints is exceeded, the loading fails.

config LOSCFG_DRIVERS_USB_MASS_STORAGE_MAX_RW_SECTORS
    int "USB Mass Storage Max Read/Write Sectors"
    range 4 128
    default 4
    depends on LOSCFG_DRIVERS_USB_MASS_STORAGE_GADGET

config LOSCFG_DRIVERS_USB_MASS_STORAGE_MAX_BUF_NUM
    int "Set USB Mass Storage RW Max Buffer Numbers"
    range 1 4
    default 2
    depends on LOSCFG_DRIVERS_USB_MASS_STORAGE_GADGET

config LOSCFG_USB_MASS_STORAGE_INDEPENDENT_MEMORY_POOL
    bool "Enable USB Mass Storage Use Independent Memory Pool"
    default n
    depends on LOSCFG_DRIVERS_USB_MASS_STORAGE_GADGET
    help
      It indicates that every transfer can read or write max numbers of sectors, one of which is 512 bytes.

config LOSCFG_DRIVERS_USB_UVC_GADGET
    bool "Enable USB Video Class Gadget"
    depends on LOSCFG_DRIVERS_USB_GADGET
    help
      If all formats are not selected, YUYV format is enabled by default.

config LOSCFG_DRIVERS_USB_UVC_IOCTL
    bool "Enable USB Video Class Ioctl Mode"
    default n
    depends on (LOSCFG_DRIVERS_USB_UVC_GADGET || LOSCFG_DRIVERS_USB_CAMERA_GADGET) && LOSCFG_FS_VFS

choice
    prompt "UVC Version"
    depends on LOSCFG_DRIVERS_USB_UVC_GADGET || LOSCFG_DRIVERS_USB_CAMERA_GADGET
    default LOSCFG_DRIVERS_USB_UVC_GADGET_VER_1_1
    help
      This selects the uvc v1.0 or v1.1.

config LOSCFG_DRIVERS_USB_UVC_GADGET_VER_1_1
    bool "UVC 1.1"
config LOSCFG_DRIVERS_USB_UVC_GADGET_VER_1_0
    bool "UVC 1.0"

endchoice

menu "UVC Format"
    depends on LOSCFG_DRIVERS_USB_UVC_GADGET || LOSCFG_DRIVERS_USB_CAMERA_GADGET

config LOSCFG_DRIVERS_USB_UVC_GADGET_YUYV
    bool "YUYV Format"
    default y

config LOSCFG_DRIVERS_USB_UVC_GADGET_NV12
    bool "NV12 Format"
    default n

config LOSCFG_DRIVERS_USB_UVC_GADGET_NV21
    bool "NV21 Format"
    default n

config LOSCFG_DRIVERS_USB_UVC_GADGET_MJPEG
    bool "MJPEG Format"
    default y

config LOSCFG_DRIVERS_USB_UVC_GADGET_H264
    bool "H264 Format"
    default y

config LOSCFG_DRIVERS_USB_UVC_GADGET_H265
    bool "H265 Format"
    default n

endmenu

choice
    depends on LOSCFG_DRIVERS_USB_UVC_GADGET || LOSCFG_DRIVERS_USB_CAMERA_GADGET
    prompt "Transter Mode"
    default LOSCFG_DRIVERS_USB_UVC_GADGET_BULK
    help
      This selects the uvc transter mode.
      Say Y to enable isochronous or bulk mode.

config LOSCFG_DRIVERS_USB_UVC_GADGET_ISOC
    bool "Isochronous Mode"

config LOSCFG_DRIVERS_USB_UVC_GADGET_BULK
    bool "Bulk Mode"

endchoice

config LOSCFG_DRIVERS_USB_UAC_GADGET
    bool "Enable USB Audio Class Gadget"
    depends on LOSCFG_DRIVERS_USB_GADGET
    help
      The microphone is enabled by default, and pause and resume during streaming transmission are supported.

choice
    depends on LOSCFG_DRIVERS_USB_UAC_GADGET || LOSCFG_DRIVERS_USB_UAC_HID_GADGET
    prompt "UAC Version"
    default LOSCFG_DRIVERS_USB_UAC_GADGET_VER_1_0
    help
      This selects the uac version.
      Say Y to enable v1.0 or v2.0.

config LOSCFG_DRIVERS_USB_UAC_GADGET_VER_1_0
    bool "UAC1.0"
    select LOSCFG_DRIVERS_USB_UAC_GADGET_MICROPHONE

config LOSCFG_DRIVERS_USB_UAC_GADGET_VER_2_0
    bool "UAC2.0"

endchoice

menu "UAC Gadget"
    depends on LOSCFG_DRIVERS_USB_UAC_GADGET || LOSCFG_DRIVERS_USB_UAC_HID_GADGET

config LOSCFG_DRIVERS_USB_UAC_GADGET_FU
    bool "Enable USB Audio Feature Unit Control"
    default n
    help
      Enable the feature unit to allow the host to control and configure specific audio functions
      of the USB audio device. Currently, only mute and volume increase and decrease are supported.

config LOSCFG_DRIVERS_USB_UAC_DYNAMIC_SPEAKER
    bool "Enable USB Audio Dynamic Speaker"
    default n
    select LOSCFG_DRIVERS_USB_UAC_GADGET_SPEAKER
    select LOSCFG_DRIVERS_USB_UAC_GADGET_MICROPHONE
    help
      When both the speaker and microphone configurations are enabled,
      the speaker functionality can be dynamically disabled at runtime.

config LOSCFG_DRIVERS_USB_UAC_MULTI_ALT_SETTING
    bool "Enable USB Audio multiple alt settings"
    default n
    help
      When activated, multiple alternate settings are enabled, with different configurations having varying bit depths
      (depending on the current configuration). You can select the desired depth from the dropdown menu in the sound
      control panel. Currently, only the microphone is supported, with options for 1 channel and 2 channels.

config LOSCFG_DRIVERS_USB_UAC_FIXED_SAMPLING_RATE
    bool "Enable USB Audio fixed sampling rate"
    default n
    help
      This indicates the uac sampling rate is fixed specified by the user, default 48k in the playback and capture.

config LOSCFG_DRIVERS_USB_UAC_GADGET_SPEAKER
    bool "Enable USB Speaker"
    default n
    help
      Speaker disabled by default.
      Say Y to enable usb speaker.
      Note that pausing and resuming during data streaming transmission are not supported.

config LOSCFG_DRIVERS_USB_UAC_GADGET_MICROPHONE
    bool "Enable USB Microphone"
    default y
    help
      microphone enable by default.

choice
    depends on LOSCFG_DRIVERS_USB_UAC_GADGET_VER_1_0 || LOSCFG_DRIVERS_USB_UAC_GADGET_VER_2_0
    prompt "UAC Bit-depth"
    default LOSCFG_DRIVERS_USB_UAC_BIT_DEPTH_16
    help
      This selects the uac bit-depth.
      The bit depth of 16bit is selected by default.
      Other bit depths can be selected according to business scenarios.

config LOSCFG_DRIVERS_USB_UAC_BIT_DEPTH_16
    bool "16 Bit"

config LOSCFG_DRIVERS_USB_UAC_BIT_DEPTH_24
    bool "24 Bit"

config LOSCFG_DRIVERS_USB_UAC_BIT_DEPTH_32
    bool "32 Bit"

endchoice

choice
    depends on LOSCFG_DRIVERS_USB_UAC_GADGET_VER_1_0 || LOSCFG_DRIVERS_USB_UAC_GADGET_VER_2_0
    prompt "UAC Channel Count"
    default LOSCFG_DRIVERS_USB_UAC_CHANNEL_1
    help
      This selects the uac channel count.
      The default number of channels is 1.

config LOSCFG_DRIVERS_USB_UAC_CHANNEL_1
    bool "1 Channel"

config LOSCFG_DRIVERS_USB_UAC_CHANNEL_2
    bool "2 Channels"

config LOSCFG_DRIVERS_USB_UAC_CHANNEL_4
    bool "4 Channels"

config LOSCFG_DRIVERS_USB_UAC_CHANNEL_8
    bool "8 Channels"
    depends on LOSCFG_DRIVERS_USB_UAC_GADGET_VER_2_0
    help
      Don't support uac1.0, because each transfer data may exceed the maximum packet length (1024 bytes)
      specified by the protocol

endchoice

config LOSCFG_DRIVERS_USB_UAC_INTERVAL
    int "Polling Interval of Data Transfer Endpoint"
    range 1 4 if LOSCFG_DRIVERS_USB_UAC_GADGET_VER_1_0
    range 1 3 if LOSCFG_DRIVERS_USB_UAC_GADGET_VER_2_0
    default 4 if LOSCFG_DRIVERS_USB_UAC_GADGET_VER_1_0
    default 3 if LOSCFG_DRIVERS_USB_UAC_GADGET_VER_2_0
    depends on LOSCFG_DRIVERS_USB_UAC_GADGET_VER_1_0 || LOSCFG_DRIVERS_USB_UAC_GADGET_VER_2_0
    help
      This indicates the polling interval of data transfer endpoint, and would be set as 4 in UAC 1.0 or 3 in UAC 2.0.
      Note, the value of uac2.0 must be set less than or equal to 3, because it may support 8 channels.

endmenu

config LOSCFG_DRIVERS_USB_CAMERA_GADGET
    bool "Enable USB Camera Class Gadget"
    depends on LOSCFG_DRIVERS_USB_GADGET && !LOSCFG_DRIVERS_USB_UAC_GADGET_SPEAKER && \
               LOSCFG_DRIVERS_USB_UAC_GADGET_MICROPHONE && !LOSCFG_DRIVERS_USB_UAC_GADGET_VER_2_0
    help
      Only UVC and UAC1.0 microphones are supported. If all UVC formats are not selected, YUYV format is enabled by default.

config LOSCFG_DRIVERS_USB_DFU_GADGET
    bool "Enable USB Dfu Gadget"
    depends on LOSCFG_DRIVERS_USB_GADGET

config LOSCFG_DRIVERS_USB_DFU_DOWNLOAD_CALLBACK
    bool "Enable USB Dfu Download Callback"
    default n
    depends on LOSCFG_DRIVERS_USB_DFU_GADGET
    help
      Set y to allow users to use download callback to process data from host. For example, write dfu data to flash.

config LOSCFG_DRIVERS_USB_DFU_FINISH_EVENT
    bool "Enable USB Dfu Finish Event"
    default n
    depends on LOSCFG_DRIVERS_USB_DFU_GADGET
    help
      Set y allows the user to call the blocking interface to wait for the event that the data download is completed.
      Note that this option must be disabled in the case of Non-OS.

config LOSCFG_DRIVERS_USB_DFU_DRIVE_FREE
    bool "Enable WinUSB Dfu Drive-free"
    default n
    depends on LOSCFG_DRIVERS_USB_DFU_GADGET
    help
      Set y to enable Drive-free loading of DFU devices only in the windows.
      This function is supported only in Windows 7 and later versions.

config LOSCFG_DRIVERS_USB_SERIAL_GADGET
    bool "Enable USB Serial Gadget"
    depends on LOSCFG_DRIVERS_USB_GADGET

choice
    prompt "Serial Interface"
    depends on (LOSCFG_DRIVERS_USB_SERIAL_GADGET || LOSCFG_DRIVERS_USB_ETH_SER_GADGET \
                || LOSCFG_DRIVERS_USB_ECM_SER_GADGET || LOSCFG_DRIVERS_USB_UAC_HID_EXT_SER_FUNC \
                || LOSCFG_DRIVERS_USB_MASS_STORAGE_EXT_SER_FUNC)
    default LOSCFG_DRIVERS_USB_SERIAL_VFS_INTERFACE
    help
      This selects the type of Serial interface.

config LOSCFG_DRIVERS_USB_SERIAL_VFS_INTERFACE
    bool "Enable Serial VFS Interface"
    depends on LOSCFG_FS_VFS
    help
      Use the VFS interface only when the VFS is enable.

config LOSCFG_DRIVERS_USB_SERIAL_FUNC_INTERFACE
    bool "Enable Serial External Interface"
    help
      Use the function interface, whether the VFS is enabled or not.

endchoice

choice
    prompt "Serial Mode"
    depends on (LOSCFG_DRIVERS_USB_SERIAL_GADGET || LOSCFG_DRIVERS_USB_ETH_SER_GADGET \
                || LOSCFG_DRIVERS_USB_ECM_SER_GADGET || LOSCFG_DRIVERS_USB_MASS_STORAGE_EXT_SER_FUNC)
    default LOSCFG_DRIVERS_USB_SERIAL_GADGET_DEFAULT
    help
      This selects the serial mode.

config LOSCFG_DRIVERS_USB_SERIAL_GADGET_DEFAULT
    bool "Default Serial"

config LOSCFG_DRIVERS_USB_SERIAL_GADGET_MULT
    bool "Multiple Serial"

config LOSCFG_DRIVERS_USB_SERIAL_COUNT
    int "Serial Num"
    range 2 3
    default 2
    depends on LOSCFG_DRIVERS_USB_SERIAL_GADGET_MULT

endchoice

config LOSCFG_DRIVERS_USB_SERIAL_NOTIFICATION_FUNC
    bool "Enable USB Serial Notification Message Function"
    default y
    depends on (LOSCFG_DRIVERS_USB_SERIAL_GADGET || LOSCFG_DRIVERS_USB_ETH_SER_GADGET \
                || LOSCFG_DRIVERS_USB_ECM_SER_GADGET)
    help
      Enable the connection status notification function of the USB virtual serial.
      If this function is disabled, some hosts, such as Windows 7, have compatibility problems.

config LOSCFG_DRIVERS_USB_ECM_GADGET
    bool "Enable USB ECM Gadget"
    depends on LOSCFG_DRIVERS_USB_GADGET && LOSCFG_COMPAT_LINUX

config LOSCFG_DRIVERS_USB_ETHERNET_GADGET
    bool "Enable USB Ethernet Class Gadget"
    depends on LOSCFG_DRIVERS_USB_GADGET && LOSCFG_COMPAT_LINUX

config LOSCFG_DRIVERS_USB_ETHERNET_CUSTOMIZED_NET_STACK
    bool "Enable Customized Network Protocol Stack"
    default n
    depends on (LOSCFG_DRIVERS_USB_ETHERNET_GADGET || LOSCFG_DRIVERS_USB_ETH_SER_GADGET \
                || LOSCFG_DRIVERS_USB_ECM_GADGET || LOSCFG_DRIVERS_USB_ECM_SER_GADGET)
    help
      Enabled when the user-defined network protocol stack is used.
      If the value is n, the network protocol stack uses lwip by default.

config LOSCFG_DRIVERS_USB_ETH_SER_GADGET
    bool "Enable USB Ethernet & Serial Gadget"
    depends on LOSCFG_DRIVERS_USB_GADGET
    help
      If this configuration is enabled, a network port or serial port occupies the 1out and 2in endpoints.
      The number of serial ports needs to be configured based on the actual number of endpoints.
      If the actual number of endpoints is exceeded, the loading fails.

config LOSCFG_DRIVERS_USB_ECM_SER_GADGET
    bool "Enable USB ECM & Serial Gadget"
    depends on LOSCFG_DRIVERS_USB_GADGET
    help
      If this configuration is enabled, a network port or serial port occupies the 1out and 2in endpoints.
      The number of serial ports needs to be configured based on the actual number of endpoints.
      If the actual number of endpoints is exceeded, the loading fails.

config LOSCFG_DRIVERS_USB_HID_GADGET
    bool "Enable USB HID Class Gadget"
    depends on LOSCFG_DRIVERS_USB_GADGET

choice
    prompt "HID Interface"
    depends on LOSCFG_DRIVERS_USB_HID_GADGET || LOSCFG_DRIVERS_USB_UAC_HID_GADGET
    default LOSCFG_DRIVERS_USB_HID_VFS_INTERFACE
    help
      This selects the type of HID interface.

config LOSCFG_DRIVERS_USB_HID_VFS_INTERFACE
    bool "Enable HID VFS Interface"
    depends on LOSCFG_FS_VFS
    help
      Use the VFS interface, but only one HID report can be set.

config LOSCFG_DRIVERS_USB_HID_FUNC_INTERFACE
    bool "Enable HID External Interface"
    help
      Use the function interface, up to two HID reports can be set.

config LOSCFG_DRIVERS_USB_HID_REPORT_MAP_NUM
    int "HID Report Map Num"
    default 2
    depends on LOSCFG_DRIVERS_USB_HID_FUNC_INTERFACE
    help
      Configure the number of HID report maps.

config LOSCFG_DRIVERS_USB_HID_POLLING_REPORTS
    bool "Enable HID Polling Reports"
    default n
    depends on LOSCFG_DRIVERS_USB2_DEVICE_CONTROLLER && LOSCFG_DRIVERS_USB_HID_FUNC_INTERFACE
    help
      Use USB SOF interrupt to send HID data.

endchoice

config LOSCFG_DRIVERS_USB_HID_INPUT_REPORT_LEN
    int "HID Input Report Length"
    default 12
    depends on LOSCFG_DRIVERS_USB_HID_GADGET || LOSCFG_DRIVERS_USB_UAC_HID_GADGET
    help
      Maximum length of the sent HID report.
      If the memory is a non-cache attribute, this value must be aligned by 4 bytes.
      If the memory is a cache attribute, this value must be aligned by USB_CACHE_ALIGN_SIZE.

config LOSCFG_DRIVERS_USB_HID_IN_DATA_SIZE
    int "HID In Endpoint Data Size"
    range 64 1024
    default 64
    depends on LOSCFG_DRIVERS_USB_HID_GADGET || LOSCFG_DRIVERS_USB_UAC_HID_GADGET
    help
      This indicates MaxPacketSize of hid in endpoint.

config LOSCFG_DRIVERS_USB_HID_OUT_DATA_SIZE
    int "HID Out Endpoint Data Size"
    range 64 1024
    default 64
    depends on LOSCFG_DRIVERS_USB_HID_GADGET || LOSCFG_DRIVERS_USB_UAC_HID_GADGET
    help
      This indicates MaxPacketSize of hid out endpoint.

config LOSCFG_DRIVERS_USB_HID_OUTPUT_REPORT
    bool "Enable HID Output Report Transfer"
    default y
    depends on LOSCFG_DRIVERS_USB_HID_GADGET || LOSCFG_DRIVERS_USB_UAC_HID_GADGET
    help
      Set y to support SET_REPORT request, receive output report sent by host, such as keyboard lights.
      Set n if hid report table has no output report feature, such as mouse.

config LOSCFG_DRIVERS_USB_UAC_HID_GADGET
    bool "Enable USB UAC & HID Gadget"
    depends on LOSCFG_DRIVERS_USB_GADGET

config LOSCFG_DRIVERS_USB_UAC_HID_EXT_SER_FUNC
    bool "Enable Extra Serial Function"
    depends on LOSCFG_DRIVERS_USB_UAC_HID_GADGET
    help
      Set y to enable the serial port function. Currently, only one serial port is supported.
      On the 3372 platform, there are 2 extra restrictions:
      The number of HID report maps must be 1.
      The USB Serial Notification Message Function must be disabled
endmenu

if LOSCFG_DRIVERS_USB_GADGET
config LOSCFG_DRIVERS_USB_COMPOSITE_GADGET
    bool
    default y
endif

config LOSCFG_DRIVERS_USB_DEVICE_NO_DRIVER_BASE
    bool
    help
        This option will allow use usb device driver without driver base framework.
        It needs to be manual selected by the platform. If this option is selected,
        platform also needs to define those neccessay usb device marcros.

        Select this if you want to reduce code size by disabling driver base.
        Note that LOSCFG_DRIVERS_BASE must be manually disabled.
```
