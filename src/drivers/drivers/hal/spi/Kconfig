## src/kernel/liteos/LiteOS/self_src/arch_lite/arm64/Kconfig
```kconfig
# Copyright (c) HiSilicon (Shanghai) Technologies Co., Ltd. 2019-2020. All rights reserved.

#
# ARM 64-bit(Aarch64) implementations
#
config LOSCFG_ARCH_ARM_AARCH64
    bool
    select LOSCFG_LIB_LIBC
    help
      64-bit ARM architecture implementations.
      AArch64 was introduced in ARMv8-A and is included in subsequent versions of ARMV8-A.

#
# Architecture Versions
#
config LOSCFG_ARCH_ARM_V8A
    bool
    select LOSCFG_ARCH_ARM_AARCH64
    select LOSCFG_ARCH_PMU
    help
      ARMv8-A supported Aarch32 and Aarch64. If this option is chosen, the target platform needs
      to specified whether the core runs in Aarch32 or Aarch64 mode.

config LOSCFG_ARCH_ARM_VER
    string
    default "armv8-a" if LOSCFG_ARCH_ARM_V8A

config LOSCFG_ARCH_ARM_AARCH64_LSE
    bool
    help
        Support armv8.1-lse feature.

config LOSCFG_ARCH_ARM_AARCH64_LSE_ATOMIC
    bool
    default y
    prompt "Enable armv8.1-lse atomic instructions"
    depends on LOSCFG_ARCH_ARM_AARCH64_LSE
    help
        Enable armv8.1-lse atomic instructions.

#
# Supported Processor Cores
#
config LOSCFG_ARCH_CORTEX_A53
    bool
    select LOSCFG_ARCH_ARM_V8A

config LOSCFG_ARCH_CORTEX_A55
    bool
    select LOSCFG_ARCH_ARM_V8A
    select LOSCFG_ARCH_ARM_AARCH64_LSE

config LOSCFG_ARCH_LINXCORE_610
    bool
    select LOSCFG_ARCH_ARM_V8A
    select LOSCFG_ARCH_ARM_AARCH64_LSE

config LOSCFG_ARCH_CPU
    string
    default "cortex-a53" if LOSCFG_ARCH_CORTEX_A53
# No cortex-a55 compiler. Use the cortex-a53 compiler.
    default "cortex-a53" if LOSCFG_ARCH_CORTEX_A55
# No linx610 compiler. Use the cortex-a76 compiler.
    default "cortex-a76" if LOSCFG_ARCH_LINXCORE_610

config LOSCFG_ARCH_RAS
    bool
    default n
    depends on LOSCFG_ARCH_ARM_AARCH64
    help
      This option allows CPUs that support Reliability, Availability and Serviceability (RAS) extensions.

menu "Mmu Configurations"
    depends on LOSCFG_ARCH_MMU_ENABLE
choice
    prompt "Physical page size"
config LOSCFG_ARCH_ARM64_4K_PAGES
    bool "4KB"
endchoice
config LOSCFG_ARCH_ARM64_PAGE_SIZE
    hex
    default 0x1000 if LOSCFG_ARCH_ARM64_4K_PAGES
config LOSCFG_ARCH_ARM64_PAGE_SHIFT
    int
    default 12 if LOSCFG_ARCH_ARM64_4K_PAGES
choice
    prompt "Virtual address bits"
    default LOSCFG_ARCH_ARM64_VA_BITS_39
    help
      Choose the maximum virtual address space size.
config LOSCFG_ARCH_ARM64_VA_BITS_39
    depends on LOSCFG_ARCH_ARM64_4K_PAGES
    bool "39-bit"
config LOSCFG_ARCH_ARM64_VA_BITS_48
    bool "48-bit"
endchoice
config LOSCFG_ARCH_ARM64_VA_BITS
    int
    default 39 if LOSCFG_ARCH_ARM64_VA_BITS_39
    default 48 if LOSCFG_ARCH_ARM64_VA_BITS_48
choice
    prompt "Physical address bits"
    default LOSCFG_ARCH_ARM64_PA_BITS_40
    help
      Choose the maximum physical address space size referring to ID_AA64MMFR0_EL1.PARange register.
config LOSCFG_ARCH_ARM64_PA_BITS_32
    bool "32-bit"
config LOSCFG_ARCH_ARM64_PA_BITS_36
    bool "36-bit"
config LOSCFG_ARCH_ARM64_PA_BITS_40
    bool "40-bit"
config LOSCFG_ARCH_ARM64_PA_BITS_42
    bool "42-bit"
config LOSCFG_ARCH_ARM64_PA_BITS_44
    bool "44-bit"
config LOSCFG_ARCH_ARM64_PA_BITS_48
    bool "48-bit"
endchoice
config LOSCFG_ARCH_ARM64_PA_BITS
    int
    default 32 if LOSCFG_ARCH_ARM64_PA_BITS_32
    default 36 if LOSCFG_ARCH_ARM64_PA_BITS_36
    default 40 if LOSCFG_ARCH_ARM64_PA_BITS_40
    default 42 if LOSCFG_ARCH_ARM64_PA_BITS_42
    default 44 if LOSCFG_ARCH_ARM64_PA_BITS_44
    default 48 if LOSCFG_ARCH_ARM64_PA_BITS_48
config LOSCFG_ARCH_MMU_PAGE_TBL_LVL
    int
    default 3 if LOSCFG_ARCH_ARM64_VA_BITS_39 && LOSCFG_ARCH_ARM64_4K_PAGES
    default 4 if LOSCFG_ARCH_ARM64_VA_BITS_48 && LOSCFG_ARCH_ARM64_4K_PAGES
    help
        The level of page tables is determined by page size and virtual address bits.
        Bits num of Ln page table level equals 3 subtracted from page shift bits num,
        then table levels num can be calculated by va bits num.
        Ex2: 4K granule / 39-bits --> (39 - 12) / (12 - 3) = 3
        Ex1: 4K granule / 48-bits --> (48 - 12) / (12 - 3) = 4

config LOSCFG_ARCH_ARM64_TEMP_PGTABLE_L1
    bool
    depends on !LOSCFG_ARCH_ARM64_TEMP_PGTABLE_L2 && !LOSCFG_ARCH_ARM64_TEMP_PGTABLE_L3
    help
      Level1 1G.
config LOSCFG_ARCH_ARM64_TEMP_PGTABLE_L2
    bool
    depends on !LOSCFG_ARCH_ARM64_TEMP_PGTABLE_L3
    help
      Level2 2M.
config LOSCFG_ARCH_ARM64_TEMP_PGTABLE_L3
    bool
    help
      Level3 4K.
endmenu

config LOSCFG_ARCH_EXC_RECOVER
    bool "Enable Exception recovery mechanism"
    default n
    depends on LOSCFG_ARCH_ARM_AARCH64
    help
      This option will Enable Exception recovery mechanism.
```

## src/kernel/liteos/LiteOS/self_src/arch_lite/linglong/Kconfig
```kconfig
# Copyright (c) HiSilicon (Shanghai) Technologies Co., Ltd. 2021-2021. All rights reserved.

#
# Linglong arch implementations
#
config LOSCFG_ARCH_LINGLONG
    bool
    select LOSCFG_ARCH_PMU
    help
      Linglong architecture implementations.

config LOSCFG_ARCH_CPU
    string
    default "linglong"  if LOSCFG_ARCH_LINGLONG
    
```

## src/kernel/liteos/LiteOS/self_src/compat/Kconfig
```kconfig
menu "Compat"
orsource "cmsis/Kconfig"
orsource "linux/Kconfig"
orsource "rt-thread/Kconfig"
orsource "freertos/Kconfig"
endmenu
```

## src/kernel/liteos/LiteOS/self_src/compat/cmsis/Kconfig
```kconfig
config LOSCFG_COMPAT_CMSIS
    bool "Enable Cmsis"
    default n
    depends on !LOSCFG_KERNEL_SMP && (LOSCFG_KERNEL_MIN || LOSCFG_SAFETY_KERNEL)
    help
      Answer Y to enable LiteOS support cmsis interface.

config OS_OPTION_COMPAT_CMSIS
    bool "Enable Cmsis"
    default n
    depends on OS_OPTION_LOS
    help
      Answer Y to enable RTOS_Lite support cmsis interface.

if LOSCFG_COMPAT_CMSIS || OS_OPTION_COMPAT_CMSIS

config LOSCFG_COMPAT_CMSIS_VER_1
    bool "Enable Cmsis Version 1.0"
    default n
    select LOSCFG_KERNEL_MEMBOX if !LOSCFG_BOX
    select LOSCFG_KERNEL_MEM_ALLOC if LOSCFG_BOX
    select LOSCFG_MEMBOX if LOSCFG_BOX
    help
      The Cmsis Version 1.

config LOSCFG_COMPAT_CMSIS_VER_2
    bool "Enable Cmsis Version 2.0"
    default y
    select LOSCFG_KERNEL_MEM_ALLOC
    help
      The Cmsis Version 2.

config LOSCFG_COMPAT_CMSIS_STATIC_ALLOCATION
    bool "CMSIS Support Static Memory"
    depends on !LOSCFG_COMPAT_CMSIS_VER_2 && LOSCFG_COMPAT_CMSIS
    select LOSCFG_TASK_STACK_STATIC_ALLOCATION
    select LOSCFG_QUEUE_STATIC_ALLOCATION if LOSCFG_BASE_IPC_QUEUE
    default n
    help
      Answer Y to enable LiteOS support cmsis interface.

endif # LOSCFG_COMPAT_CMSIS
```

## src/kernel/liteos/LiteOS/self_src/compat/rt-thread/Kconfig
```kconfig
config LOSCFG_COMPAT_RT_THREAD
    bool "Enable RT_Thread"
    default n
    select LOSCFG_TASK_STACK_STATIC_ALLOCATION
    help
      Answer Y to enable LiteOS support RT_Thread interface.
```

## src/kernel/liteos/LiteOS/self_src/drivers/iommu/Kconfig
```kconfig
config LOSCFG_DRIVERS_IOMMU
    bool "Enable IOMMU"
    depends on LOSCFG_ARCH_LINXCORE_131 && LOSCFG_APC_ENABLE
    default n
    help
      Answer Y to enable LiteOS to support iommu

choice
    prompt "IOMMU Support Type"
    default LOSCFG_DRIVERS_HISI_CUSTOM_IOMMU
    depends on LOSCFG_DRIVERS_IOMMU
    help
      Choose LiteOS IOMMU driver.

config LOSCFG_DRIVERS_HISI_CUSTOM_IOMMU
    bool "Hisi Custom IOMMU"
    depends on LOSCFG_DRIVERS_IOMMU

endchoice

choice
    prompt "IOMMU Virtual Address Bits"
    default LOSCFG_DRIVERS_IOMMU_VA_BITS_36
    depends on LOSCFG_DRIVERS_IOMMU
    help
      Choose the maximum virtual address space size.
config LOSCFG_DRIVERS_IOMMU_VA_BITS_36
    bool "36-bit"
endchoice

config LOSCFG_DRIVERS_IOMMU_VA_BITS
    int
    default 36 if LOSCFG_DRIVERS_IOMMU_VA_BITS_36
```

## src/kernel/liteos/LiteOS/self_src/drivers/mmc/adapt_liteos/Kconfig
```kconfig
config LOSCFG_DRIVERS_MMC
    bool "Enable MMC"
    default n
    depends on LOSCFG_FS_VFS
    select LOSCFG_BASE_CORE_SWTMR
    select LOSCFG_BASE_IPC_SEM
    select LOSCFG_DRIVER_DISK
    select LOSCFG_COMPAT_LINUX
    select LOSCFG_COMPAT_LINUX_DRIVER_BASE
    help
      Answer Y to enable LiteOS support MMC driver.

config LOSCFG_DRIVERS_MMC_TASK_PRI
    int "sdio_Task priority"
    default 2
    depends on LOSCFG_DRIVERS_MMC
    help
      specify the priority of sdio_Task.

config LOSCFG_DRIVERS_MMC_TASK_STACK_SIZE
    int "sdio_Task stack size"
    default 0x2000
    depends on LOSCFG_DRIVERS_MMC
    help
      specify the stack size of sdio_Task.

choice
    depends on LOSCFG_DRIVERS_MMC
    prompt "MMC Controller"
    default LOSCFG_DRIVERS_MMC_CONTROLLER_SDHCI
    help
      select SDHCI controller.
      select SDMCI controller.
      select select HISDEMMC controller.

config LOSCFG_DRIVERS_MMC_CONTROLLER_SDHCI
    depends on LOSCFG_DRIVERS_MMC
    bool "Enable SDHCI Controller"
    help
       Answer Y to enable standard SDHCI controller

config LOSCFG_DRIVERS_MMC_CONTROLLER_SDMCI
    depends on LOSCFG_DRIVERS_MMC
    bool "Enable SDMCI Controller"
    help
       Answer Y to enable standard SDMCI controller

config LOSCFG_DRIVERS_MMC_HISDEMMC
    depends on LOSCFG_DRIVERS_MMC
    bool "Enable HISDEMMC Controller"
    help
       Answer Y to enable HISDEMMC controller
endchoice

choice
    depends on LOSCFG_DRIVERS_MMC
    prompt "MMC0 support device type"
    default LOSCFG_DRIVERS_SD
    help
      Enable LiteOS MMC driver support SD card.
      Enable LiteOS MMC driver support eMMC.

config LOSCFG_DRIVERS_SD
    depends on LOSCFG_DRIVERS_MMC
    bool "Enable MMC0 support SD card type"

config LOSCFG_DRIVERS_EMMC
    depends on LOSCFG_DRIVERS_MMC
    bool "Enable MMC0 support eMMC type"
endchoice


choice
    depends on LOSCFG_DRIVERS_EMMC && LOSCFG_DRIVERS_MMC && LOSCFG_FS_VFS
    prompt "EMMC chip mode"
    default LOSCFG_DRIVERS_EMMC_HS200
    help
      select EMMC chip mode hs200.
      select EMMC chip mode hs400.
      select EMMC chip mode hs400es.

config LOSCFG_DRIVERS_EMMC_HS200
    depends on LOSCFG_DRIVERS_EMMC
    bool "Enable EMMC HS200 support"
    help
       If you connect the SDIO0 to EMMC chip, figure out which mode of chip and select the mode HS200

config LOSCFG_DRIVERS_EMMC_HS400
    depends on LOSCFG_DRIVERS_EMMC && LOSCFG_PLATFORM_HI3516EV300
    bool "Enable EMMC HS400 support"
    help
       If you connect the SDIO0 to EMMC chip figure out which mode of chip and select the mode HS400

config LOSCFG_DRIVERS_EMMC_HS400ES
    depends on LOSCFG_DRIVERS_EMMC && LOSCFG_PLATFORM_HI3516EV300
    bool "Enable EMMC HS400ES support"
    help
       If you connect the SDIO0 to EMMC chip figure out which mode of chip and select the mode HS400ES
endchoice

config LOSCFG_DRIVERS_MMC_RW_IN_BOOT_AND_EXC
    depends on LOSCFG_DRIVERS_MMC && (LOSCFG_PLATFORM_SUQIN_APP || LOSCFG_PLATFORM_SW21_APP || LOSCFG_PLATFORM_SW21_APP_SE || LOSCFG_PLATFORM_SW22_APP || LOSCFG_PLATFORM_SW22_APP_SE)
    default n
    bool "Enable write/read in boot and exception"
    help
      Answer Y to enable MMC driver write/read before system startup (before scheduling is enabled) and in exception.

config LOSCFG_DRIVERS_MMC_RPMB
    bool "Enable MMC RPMB"
    default n
    depends on LOSCFG_DRIVERS_MMC && LOSCFG_DRIVERS_MMC_HISDEMMC
    help
      Answer Y to enable LiteOS to support mmc RPMB.

config LOSCFG_DRIVERS_MMC_EXT_CLK_SWITCH
    bool "Enable MMC external clock switch"
    default n
    depends on LOSCFG_DRIVERS_MMC && LOSCFG_DRIVERS_MMC_HISDEMMC
    help
      Answer Y to enable LiteOS to support mmc external clock switch.

config LOSCFG_DRIVERS_MMCSD_EXT_POWER_UP_DOWN
    bool "Enable MMC SD POWER SWITCH"
    default n
    depends on LOSCFG_DRIVERS_MMC && LOSCFG_DRIVERS_MMC_HISDEMMC && LOSCFG_DRIVERS_SD
    help
      Answer Y to support the function that the mmc sd card power up or power down.

config LOSCFG_DRIVERS_MMC_DMA_CACHE_DISABLE
    bool "Disable MMC DMA CACHE"
    default n
    depends on LOSCFG_DRIVERS_MMC && LOSCFG_DRIVERS_MMC_HISDEMMC
    help
      Answer Y to enable LiteOS to support ADMA2.

config LOSCFG_MMCSD_TASK_STACK_SIZE
    int "mmcsd Task Stack Size"
    default 3072
    range LOSCFG_BASE_CORE_TSK_MIN_STACK_SIZE 65535
    help
      This represents the mmcsd Task task default stack size .
```

## src/kernel/liteos/LiteOS/self_src/drivers/timer/Kconfig
```kconfig
config LOSCFG_TIMER_VENDOR
    bool
    help
      Use vendor timer driver.

config LOSCFG_ARM_GENERIC_TIMER
    bool
    help
      ARM generic timer.

config LOSCFG_ARM_PRIVATE_TIMER
    bool
    help
      ARM private timer.

config LOSCFG_CORTEX_M_SYSTICK
    bool
    help
      ARM cortex-m systick.

config LOSCFG_ARM_SP804_TIMER
    bool
    help
      ARM sp804 dual timer.

config LOSCFG_ARM_SP804_HRTIMER
    bool
    help
      ARM sp804 dual timer as hrtimer.

config LOSCFG_XTENSA_XEA2_TIMER
    bool
    help
      Xtensa xea2 systick.

config LOSCFG_XTENSA_XEA3_TIMER
    bool
    help
      Xtensa xea3 systick.

config LOSCFG_ARM_SP804_ADVANCED
    bool
    select LOSCFG_BASE_CORE_SWTMR
    help
      If enabled advanced driver of ARM sp804 timer.
      If enabled, then use a swtmr and an additional hardware timer to record the system running period.

config LOSCFG_RISCV32_M_TIMER
    bool
    help
      RISCV32 machine timer.

config LOSCFG_RISCV_HQTIMER_V500
    bool
    help
      Used for specific vendor timer.

config LOSCFG_RISCV_HQTIMER_V510
    bool
    help
      Used for specific vendor timer.

config LOSCFG_LINGLONG_TIMER
    bool
    help
        LingLong1000V100 Timer
```
