## src/drivers/drivers/hal/spi/Kconfig
```kconfig
#===============================================================================
# @brief    Kconfig file.
# Copyright (c) HiSilicon (Shanghai) Technologies Co., Ltd. 2022-2022. All rights reserved.
#===============================================================================
config SPI_USING_V100
    bool
    prompt "Using SPI V100."
    default y
    depends on DRIVER_SUPPORT_SPI

config SPI_USING_V151
    bool
    prompt "Using SPI V151."
    default y
    depends on DRIVER_SUPPORT_SPI

config SPI_USING_V151_100
    bool
    prompt "Using SPI V151_100."
    default n
    depends on DRIVER_SUPPORT_SPI

config SPI_IP_VERSION_V151_PRO
    bool
    prompt "Using SPI V151 with updata."
    default n
    depends on DRIVER_SUPPORT_SPI

choice
    prompt "Select SPI expend mode."
    default SPI_SUPPORT_SINGLE_SPI_TYPE_B
    config SPI_SUPPORT_SINGLE_SPI_TYPE_A
        bool "SPI support expend A mode."
        depends on SPI_IP_VERSION_V151_PRO
    config SPI_SUPPORT_SINGLE_SPI_TYPE_B
        bool "SPI support expend B mode."
    config SPI_SUPPORT_SINGLE_SPI_TYPE_C
        bool "SPI support expend C mode."
endchoice
```

## src/kernel/Kconfig
```kconfig
#===============================================================================
# @brief    Kconfig file.
# Copyright (c) HiSilicon (Shanghai) Technologies Co., Ltd. 2023-2023. All rights reserved.
#===============================================================================
config DRIVER_SUPPORT_LITEOS
    bool
    prompt "Use LiteOS"
    default y
    help
        This option means support LiteOS.

if DRIVER_SUPPORT_LITEOS
    osource "kernel/liteos/Kconfig"
endif

menu "osal"
    comment "Config osal."
    osource "kernel/osal/Kconfig"
endmenu

menu "nonos"
    comment "Config nonos."
    osource "kernel/non_os/Kconfig"
endmenu

config DRIVER_SUPPORT_SELITEOS
    bool
    prompt "Use SELiteOS"
    default n
    help
        This option means support SELiteOS.

if DRIVER_SUPPORT_SELITEOS
menu "seliteos"
    osource "kernel/seliteos/Kconfig"
endmenu
endif
```

## src/kernel/liteos/Kconfig
```kconfig
#===============================================================================
# @brief    Kconfig file.
# Copyright (c) HiSilicon (Shanghai) Technologies Co., Ltd. 2023-2023. All rights reserved.
#===============================================================================
config DRIVER_SUPPORT_LITEOS_208_6_0_B017_CAT1
    bool
    prompt "LiteOS_208_6_0_B017_CAT1"
    default n
    help
        This option means support LiteOS_208_6_0.
    depends on DRIVER_SUPPORT_LITEOS

if DRIVER_SUPPORT_LITEOS_208_6_0_B017_CAT1
    osource "kernel/liteos/liteos_v208.6.0_b017_cat1/Kconfig"
endif

config DRIVER_SUPPORT_LITEOS_208_7_0_B012_FHL2
    bool
    prompt "LiteOS_208_7_0_B012_FHL2"
    default n
    help
        This option means support LiteOS_208_7_0.
    depends on DRIVER_SUPPORT_LITEOS

if DRIVER_SUPPORT_LITEOS_208_7_0_B012_FHL2
    osource "kernel/liteos/liteos_v208.7.0/Kconfig"
endif

config DRIVER_SUPPORT_LITEOS_208_6_0_B017
    bool
    prompt "LiteOS_208_6_0_B017"
    default n
    help
        This option means support LiteOS_208_6_0.
    depends on DRIVER_SUPPORT_LITEOS

if DRIVER_SUPPORT_LITEOS_208_6_0_B017
    osource "kernel/liteos/liteos_v208.6.0_b017/Kconfig"
endif

config DRIVER_SUPPORT_LITEOS_208_5_0_B004
    bool
    prompt "LiteOS_208_5_0_B004"
    default n
    help
        This option means support LiteOS_208_5_0.
    depends on DRIVER_SUPPORT_LITEOS

if DRIVER_SUPPORT_LITEOS_208_5_0
    osource "kernel/liteos/liteos_v208.5.0_b004/Kconfig"
endif

config DRIVER_SUPPORT_LITEOS_208_5_0
    bool
    prompt "LiteOS_208_5_0"
    default n
    help
        This option means support LiteOS_208_5_0.
    depends on DRIVER_SUPPORT_LITEOS

if DRIVER_SUPPORT_LITEOS_208_5_0
    osource "kernel/liteos/liteos_v208.5.0/Kconfig"
endif

config DRIVER_SUPPORT_LITEOS_208_8_0_B010
    bool
    prompt "LiteOS_208_8_0_B010"
    default n
    help
        This option means support LiteOS_208_8_0_B010.
    depends on DRIVER_SUPPORT_LITEOS

if DRIVER_SUPPORT_LITEOS_208_8_0_B010
    osource "kernel/liteos/liteos_v208.8.0_b010/Kconfig"
endif

config DRIVER_SUPPORT_LITEOS_208_9_0
    bool
    prompt "LiteOS_208_9_0"
    default n
    help
        This option means support LiteOS_208_9_0.
    depends on DRIVER_SUPPORT_LITEOS

if DRIVER_SUPPORT_LITEOS_208_9_0
    osource "kernel/liteos/liteos_208.9.0/Kconfig"
endif
```

## src/kernel/liteos/LiteOS/self_src/arch_lite/arm/Kconfig
```kconfig
# Copyright (c) HiSilicon (Shanghai) Technologies Co., Ltd. 2019-2021. All rights reserved.

#
# ARM 32-bit(Aarch32) implementations
#
config LOSCFG_ARCH_ARM_AARCH32
    bool
    help
      32-bit ARM architecture implementations.
      It is not limited to ARMv7-A but also ARMv7-R, ARMv7-M and etc.

config LOSCFG_ARCH_ARM_WITH_THUMB_INSTRUCTION
    bool
    depends on LOSCFG_ARCH_ARM_CORTEX_A || LOSCFG_ARCH_ARM_CORTEX_R

config LOSCFG_ARCH_ARM_CORTEX_A
    bool
    select LOSCFG_ARCH_ARM_AARCH32

config LOSCFG_ARCH_ARM_CORTEX_R
    bool
    select LOSCFG_ARCH_ARM_AARCH32

config LOSCFG_ARCH_ARM_CORTEX_M
    bool
    select LOSCFG_ARCH_ARM_AARCH32

config LOSCFG_ARCH_ARM_V5
    bool
    select LOSCFG_ARCH_ARM_AARCH32

#
# Architecture Versions
#
config LOSCFG_ARCH_ARM_V7A
    bool
    select LOSCFG_ARCH_ARM_CORTEX_A
    select LOSCFG_ARCH_PMU

config LOSCFG_ARCH_ARM_V8A_AARCH32
    bool
    select LOSCFG_ARCH_ARM_CORTEX_A
    help
      ARMv8-A supported Aarch32 and Aarch64. This option is for ARMv8-A cores running
      at Aarch32 mode.

config LOSCFG_ARCH_ARM_V7R
    bool
    select LOSCFG_ARCH_ARM_CORTEX_R
    select LOSCFG_ARCH_PMU

config LOSCFG_ARCH_ARM_V7M
    bool
    select LOSCFG_ARCH_ARM_CORTEX_M

config LOSCFG_ARCH_ARM_V8R
    bool
    select LOSCFG_ARCH_ARM_CORTEX_R

config LOSCFG_ARCH_ARM_V8M
    bool
    select LOSCFG_ARCH_ARM_CORTEX_M
    select LOSCFG_ARCH_PMU

config LOSCFG_ARCH_ARM_VER
    string
    default "armv5"   if LOSCFG_ARCH_ARM_V5
    default "armv6-m" if LOSCFG_ARCH_ARM_V6M
    default "armv7-a" if LOSCFG_ARCH_ARM_V7A
    default "armv7-r" if LOSCFG_ARCH_ARM_V7R
    default "armv7-m" if LOSCFG_ARCH_ARM_V7M
    default "armv8-a" if LOSCFG_ARCH_ARM_V8A_AARCH32
    default "armv8-r" if LOSCFG_ARCH_ARM_V8R
    default "armv8.1-m.main" if LOSCFG_ARCH_CORTEX_M55

#
# VFP Hardware
#
config LOSCFG_ARCH_FPU_VFP_V3
    bool
    help
      An optional extension to the Arm, Thumb, and ThumbEE instruction sets in the ARMv7-A and ARMv7-R profiles.
      VFPv3U is a variant of VFPv3 that supports the trapping of floating-point exceptions to support code.

config LOSCFG_ARCH_FPU_VFP_V4
    bool
    help
      An optional extension to the Arm, Thumb, and ThumbEE instruction sets in the ARMv7-A and ARMv7-R profiles.
      VFPv4U is a variant of VFPv4 that supports the trapping of floating-point exceptions to support code.
      VFPv4 and VFPv4U add both the Half-precision Extension and the fused multiply-add instructions to the features of VFPv3.

config LOSCFG_ARCH_FPU_VFP_V5
    bool
    help
      An optional extension to the Arm, Thumb, and ThumbEE instruction sets in the ARMv7-A ARMv7-R and ARMv7-M profiles.
      Addition of double-precision operand support for existing data processing instructions in FPv4-SP-D16-M.
      16 double-precision registers. This is the same as for FPv4 and there are no additional registers.
      Software-enable control for single-precision and double-precision support using CPACR.
      Double-precision and single-precision support, when both are implemented, cannot be enabled independently of one another.
      Identical load/store instruction support to FPv4 extensions that already includes support for 64-bit data types.

config LOSCFG_ARCH_FPU_VFP_D16
    bool
    depends on LOSCFG_ARCH_ARM_AARCH32
    help
      VPU implemented with 16 doubleword registers (16 x 64-bit).

config LOSCFG_ARCH_FPU_VFP_D32
    bool
    depends on LOSCFG_ARCH_ARM_AARCH32
    help
      VPU implemented with 32 doubleword registers (32 x 64-bit).

config LOSCFG_ARCH_FPU_VFP_DP
    bool
    help
      Double precision.

config LOSCFG_ARCH_FPU_VFP_NEON
    bool
    help
      Advanced SIMD extension (NEON) support.

config LOSCFG_ARCH_FPU
    string
    default "vfpv3"       if LOSCFG_ARCH_FPU_VFP_V3 && LOSCFG_ARCH_FPU_VFP_D32
    default "vfpv3-d16"   if LOSCFG_ARCH_FPU_VFP_V3 && LOSCFG_ARCH_FPU_VFP_D16
    default "neon-vfpv4"  if LOSCFG_ARCH_FPU_VFP_V4 && LOSCFG_ARCH_FPU_VFP_D32 && LOSCFG_ARCH_FPU_VFP_NEON
    default "vfpv4"       if LOSCFG_ARCH_FPU_VFP_V4 && LOSCFG_ARCH_FPU_VFP_D32
    default "fpv4-sp-d16" if LOSCFG_ARCH_FPU_VFP_V4 && LOSCFG_ARCH_FPU_VFP_D16 && LOSCFG_ARCH_ARM_V7M
    default "vfpv4-d16"   if LOSCFG_ARCH_FPU_VFP_V4 && LOSCFG_ARCH_FPU_VFP_D16
    default "fpv5-d16"    if LOSCFG_ARCH_FPU_VFP_V5 && LOSCFG_ARCH_FPU_VFP_D16 && LOSCFG_ARCH_FPU_VFP_DP
    default "fpv5-sp-d16" if LOSCFG_ARCH_FPU_VFP_V5 && LOSCFG_ARCH_FPU_VFP_D16

#
# TrustZone for ARMv8-M
#
config LOSCFG_TRUSTZONE
    bool "Enable TrustZone for ARMv8-M"
    default n
    depends on LOSCFG_ARCH_ARM_V8M

config LOSCFG_SECURE_REGION
    bool "Build Secure Region"
    default n
    help
        If is selected, the secure region is compiled. Otherwise, the nonSecure region is compiled.
    depends on LOSCFG_TRUSTZONE

#
# Supported Processor Cores
#
config LOSCFG_ARCH_CORTEX_M0
    bool
    select LOSCFG_ARCH_ARM_V6M
    select LOSCFG_ARCH_ARM_AARCH32

config LOSCFG_ARCH_CORTEX_M3
    bool
    select LOSCFG_ARCH_ARM_V7M
    select LOSCFG_ARCH_ARM_AARCH32
    select LOSCFG_ARCH_FPU_VFP_V3
    select LOSCFG_ARCH_FPU_VFP_D16

config LOSCFG_ARCH_CORTEX_M4
    bool
    select LOSCFG_ARCH_ARM_V7M
    select LOSCFG_ARCH_ARM_AARCH32
    select LOSCFG_ARCH_FPU_VFP_V4
    select LOSCFG_ARCH_FPU_VFP_D16

config LOSCFG_ARCH_CORTEX_M7
    bool
    select LOSCFG_ARCH_ARM_V7M
    select LOSCFG_ARCH_ARM_AARCH32
    select LOSCFG_ARCH_FPU_VFP_V5
    select LOSCFG_ARCH_FPU_VFP_D16

config LOSCFG_ARCH_CORTEX_M55
    bool
    select LOSCFG_ARCH_ARM_V8M
    select LOSCFG_ARCH_ARM_AARCH32
    select LOSCFG_ARCH_FPU_VFP_V5
    select LOSCFG_ARCH_FPU_VFP_D16

config LOSCFG_ARCH_CORTEX_A7
    bool
    select LOSCFG_ARCH_ARM_V7A
    select LOSCFG_ARCH_FPU_VFP_V4
    select LOSCFG_ARCH_FPU_VFP_D32
    select LOSCFG_ARCH_FPU_VFP_NEON

config LOSCFG_ARCH_CORTEX_A9
    bool
    select LOSCFG_ARCH_ARM_V7A
    select LOSCFG_ARCH_FPU_VFP_V3
    select LOSCFG_ARCH_FPU_VFP_D16

config LOSCFG_ARCH_CORTEX_A53_AARCH32
    bool
    select LOSCFG_ARCH_ARM_V7A
    select LOSCFG_ARCH_FPU_VFP_V4
    select LOSCFG_ARCH_FPU_VFP_D32
    select LOSCFG_ARCH_FPU_VFP_NEON

config LOSCFG_ARCH_CORTEX_R8
    bool
    select LOSCFG_ARCH_ARM_V7R
    select LOSCFG_ARCH_FPU_VFP_V3
    select LOSCFG_ARCH_FPU_VFP_D16

config LOSCFG_ARCH_ARM_926
    bool
    select LOSCFG_ARCH_ARM_V5

config LOSCFG_ARCH_CORTEX_R52
    bool
    select LOSCFG_ARCH_ARM_V8R
    select LOSCFG_ARCH_FPU_VFP_V3  if LOSCFG_ARCH_FPU_ENABLE
    select LOSCFG_ARCH_FPU_VFP_D16 if LOSCFG_ARCH_FPU_ENABLE

config LOSCFG_ARCH_CPU
    string
    default "cortex-m3"  if LOSCFG_ARCH_CORTEX_M3
    default "cortex-m4"  if LOSCFG_ARCH_CORTEX_M4
    default "cortex-m7"  if LOSCFG_ARCH_CORTEX_M7
    default "cortex-m55" if LOSCFG_ARCH_CORTEX_M55
    default "cortex-a7"  if LOSCFG_ARCH_CORTEX_A7
    default "cortex-a9"  if LOSCFG_ARCH_CORTEX_A9
    default "cortex-a53" if LOSCFG_ARCH_CORTEX_A53_AARCH32
    default "cortex-r8"  if LOSCFG_ARCH_CORTEX_R8
    default "arm926ej-s" if LOSCFG_ARCH_ARM_926
    default "cortex-r52" if LOSCFG_ARCH_CORTEX_R52
```
