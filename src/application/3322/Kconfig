## src/drivers/drivers/driver/security_unified/Kconfig
```kconfig
#===============================================================================
# @brief    Kconfig file.
# Copyright (c) HiSilicon (Shanghai) Technologies Co., Ltd. 2023-2023. All rights reserved.
#===============================================================================

# module config
config SECURITY_UNIFIED_SUPPORT_DEEP_SLEEP
    bool
    prompt "Support deepsleep feature"
    default n
    depends on DRIVER_SUPPORT_SECURITY_UNIFIED

config SECURITY_UNIFIED_SUPPORT_SYMC
    bool
    prompt "security_unified support symc"
    default y
    depends on DRIVER_SUPPORT_SECURITY_UNIFIED

# support symc mode config
config SYMC_SUPPORT_ECB
    bool
    prompt "security_unified support ECB"
    default n
    depends on SECURITY_UNIFIED_SUPPORT_SYMC

config SYMC_SUPPORT_CBC
    bool
    prompt "security_unified support CBC"
    default y
    depends on SECURITY_UNIFIED_SUPPORT_SYMC

config SYMC_SUPPORT_CTR
    bool
    prompt "security_unified support CTR"
    default y
    depends on SECURITY_UNIFIED_SUPPORT_SYMC

config SYMC_SUPPORT_OFB
    bool
    prompt "security_unified support OFB"
    default n
    depends on SECURITY_UNIFIED_SUPPORT_SYMC

config SYMC_SUPPORT_CFB8
    bool
    prompt "security_unified support CFB8"
    default n
    depends on SECURITY_UNIFIED_SUPPORT_SYMC

config SYMC_SUPPORT_CFB128
    bool
    prompt "security_unified support CFB128"
    default n
    depends on SECURITY_UNIFIED_SUPPORT_SYMC

config SYMC_SUPPORT_CCM
    bool
    prompt "security_unified support CCM"
    default n
    depends on SECURITY_UNIFIED_SUPPORT_SYMC

config SYMC_SUPPORT_GCM
    bool
    prompt "security_unified support GCM"
    default y
    depends on SECURITY_UNIFIED_SUPPORT_SYMC

config SYMC_SUPPORT_CMAC
    bool
    prompt "security_unified support CMAC"
    default n
    depends on SECURITY_UNIFIED_SUPPORT_SYMC

config SYMC_SUPPORT_CBC_MAC
    bool
    prompt "security_unified support CBC_MAC"
    default n
    depends on SECURITY_UNIFIED_SUPPORT_SYMC

config SYMC_SUPPORT_CRC16
    bool
    prompt "security_unified support CRC16"
    default n
    depends on SECURITY_UNIFIED_SUPPORT_SYMC

config SYMC_SUPPORT_CRC32
    bool
    prompt "security_unified support CRC32"
    default n
    depends on SECURITY_UNIFIED_SUPPORT_SYMC

config SECURITY_UNIFIED_SUPPORT_HASH
    bool
    prompt "security_unified support hash"
    default y
    depends on DRIVER_SUPPORT_SECURITY_UNIFIED

# support hash mode config
config HASH_SUPPORT_SHA1
    bool
    prompt "security_unified support sha1"
    default n
    depends on SECURITY_UNIFIED_SUPPORT_HASH

config HASH_SUPPORT_SHA224
    bool
    prompt "security_unified support sha224"
    default n
    depends on SECURITY_UNIFIED_SUPPORT_HASH

config HASH_SUPPORT_SHA256
    bool
    prompt "security_unified support sha256"
    default y
    depends on SECURITY_UNIFIED_SUPPORT_HASH

config HASH_SUPPORT_SHA384
    bool
    prompt "security_unified support sha384"
    default y
    depends on SECURITY_UNIFIED_SUPPORT_HASH

config HASH_SUPPORT_SHA512
    bool
    prompt "security_unified support sha512"
    default y
    depends on SECURITY_UNIFIED_SUPPORT_HASH

config HASH_SUPPORT_SM3
    bool
    prompt "security_unified support sm3"
    default y
    depends on SECURITY_UNIFIED_SUPPORT_HASH

# support hmac mode config
config HASH_SUPPORT_HMAC_SHA1
    bool
    prompt "security_unified support hmac sha1"
    default n
    depends on SECURITY_UNIFIED_SUPPORT_HASH

config HASH_SUPPORT_HMAC_SHA224
    bool
    prompt "security_unified support hmac sha224"
    default n
    depends on SECURITY_UNIFIED_SUPPORT_HASH

config HASH_SUPPORT_HMAC_SHA256
    bool
    prompt "security_unified support hmac sha256"
    default y
    depends on SECURITY_UNIFIED_SUPPORT_HASH

config HASH_SUPPORT_HMAC_SHA384
    bool
    prompt "security_unified support hmac sha384"
    default y
    depends on SECURITY_UNIFIED_SUPPORT_HASH

config HASH_SUPPORT_HMAC_SHA512
    bool
    prompt "security_unified support hmac sha512"
    default y
    depends on SECURITY_UNIFIED_SUPPORT_HASH

config HASH_SUPPORT_HMAC_SM3
    bool
    prompt "security_unified support hmac sm3"
    default y
    depends on SECURITY_UNIFIED_SUPPORT_HASH

config HASH_SUPPORT_HKDF
    bool
    prompt "security_unified support hkdf"
    default y
    depends on SECURITY_UNIFIED_SUPPORT_HASH

config SPACC_IRQ_ENABLE
    bool
    prompt "security_unified support spacc irq"
    default n
    depends on SECURITY_UNIFIED_SUPPORT_HASH || SECURITY_UNIFIED_SUPPORT_SYMC

config SECURITY_UNIFIED_SUPPORT_TRNG
    bool
    prompt "security_unified support trng"
    default n
    depends on DRIVER_SUPPORT_SECURITY_UNIFIED

config SECURITY_UNIFIED_SUPPORT_KM
    bool
    prompt "security_unified support km"
    default n
    depends on DRIVER_SUPPORT_SECURITY_UNIFIED

config SECURITY_UNIFIED_SUPPORT_PBKDF2
    bool
    prompt "security_unified support pbkdf2"
    default y
    depends on SECURITY_UNIFIED_SUPPORT_KM

config SECURITY_UNIFIED_SUPPORT_FAPC
    bool
    prompt "security_unified support fapc"
    default n
    depends on DRIVER_SUPPORT_SECURITY_UNIFIED

config SECURITY_UNIFIED_SUPPORT_PKE
    bool
    prompt "security_unified support pke"
    default n
    depends on DRIVER_SUPPORT_SECURITY_UNIFIED

config PKE_IRQ_ENABLE
    bool
    prompt "security_unified support pke irq"
    default n
    depends on SECURITY_UNIFIED_SUPPORT_PKE

# support curve config
config PKE_SUPPORT_ECC_FIPS_P192R
    bool
    prompt "security_unified support ecc fips192r"
    default y
    depends on SECURITY_UNIFIED_SUPPORT_PKE

config PKE_SUPPORT_ECC_FIPS_P224R
    bool
    prompt "security_unified support ecc fips224r"
    default y
    depends on SECURITY_UNIFIED_SUPPORT_PKE

config PKE_SUPPORT_ECC_FIPS_P256R
    bool
    prompt "security_unified support ecc fips256r"
    default y
    depends on SECURITY_UNIFIED_SUPPORT_PKE

config PKE_SUPPORT_ECC_FIPS_P384R
    bool
    prompt "security_unified support ecc fips384r"
    default y
    depends on SECURITY_UNIFIED_SUPPORT_PKE

config PKE_SUPPORT_ECC_FIPS_P521R
    bool
    prompt "security_unified support ecc fips521r"
    default y
    depends on SECURITY_UNIFIED_SUPPORT_PKE

config PKE_SUPPORT_ECC_BP256R
    bool
    prompt "security_unified support ecc brainpool p256r"
    default y
    depends on SECURITY_UNIFIED_SUPPORT_PKE

config PKE_SUPPORT_ECC_BP384R
    bool
    prompt "security_unified support ecc brainpool p384r"
    default y
    depends on SECURITY_UNIFIED_SUPPORT_PKE

config PKE_SUPPORT_ECC_BP512R
    bool
    prompt "security_unified support ecc brainpool p512r"
    default y
    depends on SECURITY_UNIFIED_SUPPORT_PKE

config PKE_SUPPORT_ECC_GET_PARAM
    bool
    prompt "security_unified support get ecc param"
    default y
    depends on SECURITY_UNIFIED_SUPPORT_PKE

config PKE_SUPPORT_CURVE
    bool
    prompt "security_unified support RFC7748"
    default y
    depends on SECURITY_UNIFIED_SUPPORT_PKE

config PKE_SUPPORT_ECC_CURVE_25519
    bool
    prompt "security_unified support curve 25519"
    default y
    depends on PKE_SUPPORT_CURVE

config PKE_SUPPORT_ECC_CURVE_448
    bool
    prompt "security_unified support curve 448"
    default y
    depends on PKE_SUPPORT_CURVE

config PKE_SUPPORT_EDWARD
    bool
    prompt "security_unified support RFC8032"
    default y
    depends on SECURITY_UNIFIED_SUPPORT_PKE

config PKE_SUPPORT_ECC_ED25519
    bool
    prompt "security_unified support Edward 25519"
    default y
    depends on PKE_SUPPORT_EDWARD

config PKE_SUPPORT_ECC_ED448
    bool
    prompt "security_unified support Edward 448"
    default n
    depends on PKE_SUPPORT_EDWARD

config PKE_SUPPORT_SM2
    bool
    prompt "security_unified support sm2"
    default y
    depends on SECURITY_UNIFIED_SUPPORT_PKE

config PKE_SUPPORT_SM2_SIGN
    bool
    prompt "security_unified support sm2 sign"
    default y
    depends on PKE_SUPPORT_SM2

config PKE_SUPPORT_SM2_VERIFY
    bool
    prompt "security_unified support sm2 verify"
    default y
    depends on PKE_SUPPORT_SM2

config PKE_SUPPORT_SM2_CRYPTO
    bool
    prompt "security_unified support sm2 crypto"
    default y
    depends on PKE_SUPPORT_SM2

config PKE_SUPPORT_RSA
    bool
    prompt "security_unified support RSA"
    default y
    depends on SECURITY_UNIFIED_SUPPORT_PKE

config PKE_RSA_V15_SUPPORT
    bool
    prompt "security_unified support RSA v15"
    default n
    depends on PKE_SUPPORT_RSA

config PKE_RSA_V21_SUPPORT
    bool
    prompt "security_unified support RSA v21"
    default n
    depends on PKE_SUPPORT_RSA

config PKE_RSA_SHA256_SUPPORT
    bool
    prompt "security_unified support RSA sha256"
    default n
    depends on PKE_SUPPORT_RSA

config PKE_RSA_SHA384_SUPPORT
    bool
    prompt "security_unified support RSA sha384"
    default n
    depends on PKE_SUPPORT_RSA

config PKE_RSA_SHA512_SUPPORT
    bool
    prompt "security_unified support RSA sha512"
    default n
    depends on PKE_SUPPORT_RSA

config PKE_RSA_LABEL_SUPPORT
    bool
    prompt "security_unified support RSA label"
    default n
    depends on PKE_SUPPORT_RSA

# feature config, eg. sign, verify, crypto, ecdh, gen_key
config PKE_SUPPORT_ECC_SIGN
    bool
    prompt "security_unified support ecc sign"
    default y
    depends on SECURITY_UNIFIED_SUPPORT_PKE

config PKE_SUPPORT_ECC_VERIFY
    bool
    prompt "security_unified support ecc verify"
    default y
    depends on SECURITY_UNIFIED_SUPPORT_PKE

config PKE_SUPPORT_ECC_ECDH
    bool
    prompt "security_unified support ecc ecdh"
    default y
    depends on SECURITY_UNIFIED_SUPPORT_PKE

config PKE_SUPPORT_ECC_GEN_KEY
    bool
    prompt "security_unified support ecc generate key"
    default y
    depends on SECURITY_UNIFIED_SUPPORT_PKE

config PKE_EC_ELGAMAL_CRYPT_SUPPORT
    bool
    prompt "security_unified support ecc elgamal crypto"
    default n
    depends on SECURITY_UNIFIED_SUPPORT_PKE

config PKE_ECC_CHECK_DOT_ON_CURVE_SUPPORT
    bool
    prompt "security_unified support ecc check dot on curve"
    default n
    depends on SECURITY_UNIFIED_SUPPORT_PKE

config PKE_SUPPORT_ECC_CAL
    bool
    prompt "security_unified support ecc big number calculation"
    default y
    depends on SECURITY_UNIFIED_SUPPORT_PKE

config PKE_SUPPORT_ECC_ADD_DOT
    bool
    prompt "security_unified support ecc big number calculation"
    default n
    depends on PKE_SUPPORT_ECC_CAL

config PKE_SUPPORT_BIG_NUMBER
    bool
    prompt "security_unified support big number calculation"
    default y
    depends on SECURITY_UNIFIED_SUPPORT_PKE
```
