## src/application/3322/Kconfig
```kconfig
#===============================================================================
# @brief    Kconfig file.
# Copyright (c) HiSilicon (Shanghai) Technologies Co., Ltd. 2023-2023. All rights reserved.
#===============================================================================

config USER_SET_INPUT_TYPE
    bool
    prompt "User Config INPUT TYPE"
    default n
    help 
        This option means support 3322 input wear config. 

if USER_SET_INPUT_TYPE
osource "application/3322/input_wear/Kconfig"
endif
```

## src/application/3322/input_wear/Kconfig
```kconfig
#===============================================================================
# @brief    Kconfig file.
# Copyright (c) HiSilicon (Shanghai) Technologies Co., Ltd. 2023-2023. All rights reserved.
#===============================================================================

choice
    prompt "TOUCH TYPE CONFIG."
    default INPUT_USING_TPTYPE_ZTW622
    config INPUT_USING_TPTYPE_ZTW622
        bool "ztw622"
    config INPUT_USING_TPTYPE_ZTW523
        bool "ztw523"
    config INPUT_USING_TPTYPE_CST820
        bool "cst820"
endchoice
```

## src/application/samples/Kconfig
```kconfig
#===============================================================================
# @brief    Kconfig file.
# Copyright (c) HiSilicon (Shanghai) Technologies Co., Ltd. 2023-2023. All rights reserved.
#===============================================================================

config ENABLE_BT_SAMPLE
    bool
    prompt "Enable the Sample of BT."
    default n
    depends on SAMPLE_ENABLE
    help
        This option means enable the sample of BT.

if ENABLE_BT_SAMPLE
osource "application/samples/bt/Kconfig"
endif

config ENABLE_PERIPHERAL_SAMPLE
    bool
    prompt "Enable the Sample of peripheral."
    default n
    depends on SAMPLE_ENABLE
    help
        This option means enable the sample of peripheral.

if ENABLE_PERIPHERAL_SAMPLE
osource "application/samples/peripheral/Kconfig"
endif

config ENABLE_WIFI_SAMPLE
    bool
    prompt "Enable the Sample of WIFI."
    default n
    depends on SAMPLE_ENABLE
    help
        This option means enable the sample of WIFI.

if ENABLE_WIFI_SAMPLE
osource "application/samples/wifi_test/Kconfig"
endif

config ENABLE_PRODUCTS_SAMPLE
    bool
    prompt "Enable the Sample of products."
    default n
    depends on SAMPLE_ENABLE
    help
        This option means enable the sample of products.

if ENABLE_PRODUCTS_SAMPLE
osource "application/samples/products/Kconfig"
endif

config ENABLE_RADAR_SAMPLE
    bool
    prompt "Enable the Sample of RADAR."
    default n
    depends on SAMPLE_ENABLE
    help
        This option means enable the sample of RADAR.

if ENABLE_RADAR_SAMPLE
osource "application/samples/radar_test/Kconfig"
endif

config ENABLE_NFC_SAMPLE
    bool
    prompt "Enable the Sample of NFC."
    default n
    depends on SAMPLE_ENABLE
    help
        This option means enable the sample of NFC.

if ENABLE_NFC_SAMPLE
osource "application/samples/nfc/Kconfig"
endif

config ENABLE_PSA_SAMPLE
    bool
    prompt "Support psa api sample."
    default n
    depends on SAMPLE_ENABLE
    help
        This option means support PSA API sample

config ENABLE_SECURITY_UNIFIED_SAMPLE
    bool
    prompt "Support security unified sample."
    default n
    depends on SAMPLE_ENABLE
    help
        This option means support security unified Sample.

config SYSTEM_MOUSE_PIN_CONFIG
    bool
    prompt "Enable mouse pin config."
    default n
    help
        This option means support mouse pin config.

if SYSTEM_MOUSE_PIN_CONFIG
    menu "System mouse Pin Configuration"
    config MOUSE_PIN_LEFT
        int
        prompt "Mouse left key pinnum."
        default 0
        depends on SYSTEM_MOUSE_PIN_CONFIG

    config MOUSE_PIN_MID
        int
        prompt "Mouse middle key pinnum."
        default 1
        depends on SYSTEM_MOUSE_PIN_CONFIG

    config MOUSE_PIN_RIGHT
        int
        prompt "Mouse right key pinnum."
        default 2
        depends on SYSTEM_MOUSE_PIN_CONFIG

    config MOUSE_PIN_QDEC_A
        int
        prompt "Mouse qdec a pinnum."
        default 3
        depends on SYSTEM_MOUSE_PIN_CONFIG

    config MOUSE_PIN_QDEC_B
        int
        prompt "Mouse qdec b pinnum."
        default 4
        depends on SYSTEM_MOUSE_PIN_CONFIG

    config MOUSE_PIN_QDEC_COMMON
        int
        prompt "Mouse qdec common pinnum."
        default 5
        depends on SYSTEM_MOUSE_PIN_CONFIG

    config MOUSE_PIN_NRESET
        int
        prompt "Mouse sensor reset pinnum."
        default 21
        depends on SYSTEM_MOUSE_PIN_CONFIG

    config MOUSE_PIN_MONTION
        int
        prompt "Mouse sensor montion pinnum."
        default 6
        depends on SYSTEM_MOUSE_PIN_CONFIG

    config MOUSE_PIN_SPI_CLK
        int
        prompt "Mouse SPI clk pinnum."
        default 28
        depends on SYSTEM_MOUSE_PIN_CONFIG

    config MOUSE_PIN_SPI_CS
        int
        prompt "Mouse SPI cs pinnum."
        default 27
        depends on SYSTEM_MOUSE_PIN_CONFIG

    config MOUSE_PIN_SPI_MOSI
        int
        prompt "Mouse SPI MOSI pinnum."
        default 30
        depends on SYSTEM_MOUSE_PIN_CONFIG

    config MOUSE_PIN_SPI_MISO
        int
        prompt "Mouse SPI MISO pinnum."
        default 31
        depends on SYSTEM_MOUSE_PIN_CONFIG
    endmenu
endif

config ENABLE_AI_SAMPLE
    bool
    prompt "Enable the Sample of AI."
    default n
    depends on SAMPLE_ENABLE
    help
        This option means enable the sample of AI.

config ENABLE_SLE_MESH_SAMPLE
    bool
    prompt "Enable the Sample of Sle Mesh."
    default y
    depends on SAMPLE_ENABLE
    help
        This option means enable the sample of SLE MESH.

if ENABLE_SLE_MESH_SAMPLE
osource "application/samples/bt/sle/mesh/Kconfig"
endif
```

## src/drivers/adapter/Kconfig
```kconfig
#===============================================================================
# @brief    Kconfig file.
# Copyright (c) HiSilicon (Shanghai) Technologies Co., Ltd. 2022-2022. All rights reserved.
#===============================================================================
config ADAPTER_OHOS
    bool
    prompt "OHOS"
    default n
    help
        This option means support OHOS.

if ADAPTER_OHOS
menu "OHOS Configuration"
    comment "Config OHOS"
    osource "drivers/adapter/ohos/Kconfig"
endmenu
endif
```

## src/drivers/adapter/ohos/Kconfig
```kconfig
#===============================================================================
# @brief    Kconfig file.
# Copyright (c) HiSilicon (Shanghai) Technologies Co., Ltd. 2022-2022. All rights reserved.
#===============================================================================
config DRIVER_SUPPORT_SFC_V2
    bool
    prompt "DRIVER_SUPPORT_SFC_V2."
    default n
    depends on ADAPTER_OHOS
```

## src/drivers/boards/3322_evb/Kconfig
```kconfig
config PRODUCT_EVB_DITING
    bool
    prompt "Product Evb DiTing"
    default n
    help
      Select this option for Product Evb DiTing.

config AT_UART_BAUDRATE
    int
    prompt "AT UART Baudrate"
    default 115200
    help
      Set the baud rate for AT UART communication.
      Default value is 115200.

config FT_DITING
    bool
    prompt "Enable FT Diting Feature"
    default n
    help
        This option enables the FT Diting feature.
```

## src/drivers/chips/3322/Kconfig
```kconfig
config ENABLE_RC_CALIBRATION
    bool
    prompt "enable rc32k calibration"
    default n

config DRIVER_SUPPORT_PWM_AON
    bool
    prompt "PWM_AON"
    default n
    help
        This option means support PWM AON.

if DRIVER_SUPPORT_PWM_AON
menu "PWM AON Configuration"
    comment "Config PWM AON"
    osource "drivers/chips/3322/pwm_aon/Kconfig"
endmenu
endif
```

## src/drivers/chips/3322/pwm_aon/Kconfig
```kconfig
#===============================================================================
# @brief    Kconfig file.
# Copyright (c) HiSilicon (Shanghai) Technologies Co., Ltd. 2022-2022. All rights reserved.
#===============================================================================
config PWM_AON_USING_V150
    bool
    prompt "Using PWM AON V150."
    default n
    depends on DRIVER_SUPPORT_PWM_AON

config PWM_AON_USING_V151
    bool
    prompt "Using PWM AON V151."
    default n
    depends on DRIVER_SUPPORT_PWM_AON

config PWM_AON_USING_V152
    bool
    prompt "Using PWM AON V152."
    default n
    depends on DRIVER_SUPPORT_PWM_AON

config PWM_AON_PRELOAD
    bool
    prompt "Using PWM AON preload."
    default n
    depends on PWM_AON_USING_V151 || PWM_AON_USING_V152

config PWM_AON_GROUP_NUM
    int
    prompt "The number of groups in PWM AON."
    range 1 16
    default 6
    depends on DRIVER_SUPPORT_PWM_AON

config PWM_AON_CHANNEL_NUM
    int
    prompt "PWM AON channel number."
    default 6
    depends on DRIVER_SUPPORT_PWM_AON

config PWM_AON_SUPPORT_TIME_32BIT
    bool
    prompt "Support time 32bit."
    default n
    depends on PWM_AON_USING_V151 || PWM_AON_USING_V152

config PWM_AON_SUPPORT_CLOCK_ENABLE
    bool
    prompt "Support PWM AON clock enable."
    default n
    depends on PWM_AON_USING_V151 || PWM_AON_USING_V152

config PWM_AON_PERIODLOAD_FLAG_BIT
    bool
    prompt "Support PWM AON periodload flag."
    default n
    depends on PWM_AON_USING_V151

config PWM_AON_IP_VERSION_V151_PRO
    bool
    prompt "The pwm ip version support seamless PWM AON waveform adjustment using DMA."
    default y
    depends on PWM_AON_USING_V151 && DRIVER_SUPPORT_LPB
```

## src/drivers/chips/Kconfig
```kconfig
#===============================================================================
# @brief    Kconfig file.
# Copyright (c) HiSilicon (Shanghai) Technologies Co., Ltd. 2022-2022. All rights reserved.
#===============================================================================

choice
    prompt "Choose Chip"
    default CHIP_BS2X
config CHIP_WS53
    bool "ws53"

config CHIP_WS63
    bool "ws63"

config CHIP_BS2X
    bool "bs2x"

config CHIP_BS25
    bool "bs25"

config CHIP_SW39
    bool "sw39"

config CHIP_FHL2
    bool "fenghuolunv200"

config CHIP_WS75
    bool "ws75"

config CHIP_BS27A
    bool "bs27a"

config CHIP_USW
    bool "usw"

config CHIP_3322
    bool "3322"

endchoice

if CHIP_WS53
menu "Chip Configurations for ws53"
    comment "Config ws53"
    osource "drivers/chips/ws53/Kconfig"
endmenu
endif

if CHIP_WS63
menu "Chip Configurations for ws63"
    comment "Config ws63"
    osource "drivers/chips/ws63/Kconfig"
endmenu
endif

if (CHIP_BS2X || CHIP_BS25)
menu "Chip Configurations for bs2x"
    comment "bs2x chipset resource config"
    osource "drivers/chips/bs2x/Kconfig"
endmenu
endif

if CHIP_BS27A
menu "Chip Configurations for bs27a"
    comment "bs27a chipset resource config"
    osource "drivers/chips/bs27a/Kconfig"
endmenu
endif

if CHIP_SW39
menu "Chip Configurations for sw39"
    comment "sw39 chipset resource config"
    osource "drivers/chips/sw39/Kconfig"
endmenu
endif

if CHIP_FHL2
menu "Chip Configurations for fenghuolunv200"
    comment "fenghuolunv200 chipset resource config"
    osource "drivers/chips/fhl2/boot/commonboot/Kconfig"
endmenu
endif

if CHIP_WS75
menu "Chip Configurations for ws75"
    comment "ws75 chipset resource config"
    osource "drivers/chips/ws75/Kconfig"
endmenu
endif

if CHIP_3322
menu "Chip Configurations for 3322"
    comment "3322 chipset resource config"
    osource "drivers/chips/3322/Kconfig"
endmenu
endif
```

## src/drivers/drivers/driver/audio/source/Kconfig
```kconfig
mainmenu "SAP SDK Configuration"

source "build/Kconfig"
source "drv/Kconfig"
source "core/Kconfig"
source "api/Kconfig"
```

## src/drivers/drivers/driver/audio/source/api/Kconfig
```kconfig
menu "Audio API Config"

menu "Audio Dump Config"
config DUMP_SUPPORT
    bool "enable dump"
    default n
    help
        enable dump in MPI

config HOOK_DATA_SUPPORT
    bool "dsp hook data support"
    default n
    depends on DUMP_SUPPORT
    help
        enable data hook in audio dsp

config HOOK_MIX_DATA_IN_SEA_SUPPORT
    bool "dsp hook mix data in sea support"
    default n
    depends on HOOK_DATA_SUPPORT
    help
        enable sea mix data hook in audio dsp

config AI_DUMP_SUPPORT
    bool "ai dump support"
    default n
    depends on DUMP_SUPPORT
    help
        enable ai dump in MPI

config SEA_DUMP_SUPPORT
    bool "sea dump support"
    default n
    depends on DUMP_SUPPORT
    help
        enable sea dump in MPI

config ADEC_DUMP_SUPPORT
    bool "adec dump support"
    default n
    depends on DUMP_SUPPORT
    help
        enable adec dump in MPI

config AENC_DUMP_SUPPORT
    bool "aenc dump support"
    default n
    depends on DUMP_SUPPORT
    help
        enable aenc dump in MPI

config TRACK_DUMP_SUPPORT
    bool "track dump support"
    default n
    depends on DUMP_SUPPORT
    help
        enable track dump in MPI

config AO_DUMP_SUPPORT
    bool "ao dump support"
    default n
    depends on DUMP_SUPPORT
    help
        enable ao dump in MPI

config DPM_DUMP_SUPPORT
    bool "dpm dump support"
    default n
    depends on DUMP_SUPPORT
    help
        enable dpm dump in MPI

endmenu ## "Audio Dump Config"
endmenu ## "Audio API Config"
```

## src/drivers/drivers/driver/audio/source/core/Kconfig
```kconfig
menu "Audio Core Config"

source "core/aoe/Kconfig"
source "core/aie/Kconfig"
source "core/component/Kconfig"
source "core/hal/Kconfig"

endmenu
```
