## src/drivers/drivers/driver/uart/Kconfig
```kconfig
#===============================================================================
# @brief    Kconfig file.
# Copyright (c) HiSilicon (Shanghai) Technologies Co., Ltd. 2022-2022. All rights reserved.
#===============================================================================

config UART_BAUD_RATE_DIV_8
    bool
    prompt "UART Baud rate div 8."
    default y
    depends on DRIVER_SUPPORT_UART

config UART_SUPPORT_TX
    bool
    prompt "UART support TX."
    default y
    depends on DRIVER_SUPPORT_UART

config SUPPORT_UART_TX_POLL_TIMEOUT
    bool
    prompt "support timeout in uart TX poll mode."
    default n
    depends on UART_SUPPORT_TX

config UART_SUPPORT_TX_INT
    bool
    prompt "UART support TX interrupt mode."
    default y
    depends on DRIVER_SUPPORT_UART

config UART_SUPPORT_RX
    bool
    prompt "UART support RX."
    default y
    depends on DRIVER_SUPPORT_UART

config UART_SUPPORT_RX_THREAD
    bool
    prompt "UART support RX thread."
    default n
    depends on UART_SUPPORT_RX

config SUPPORT_UART_RX_POLL_TIMEOUT
    bool
    prompt "support timeout in uart RX poll mode."
    default n
    depends on UART_SUPPORT_RX

config UART_SUPPORT_RX_THREAD_STACK_SIZE
    int
    prompt "UART RX thread stack size."
    default 1024
    depends on UART_SUPPORT_RX_THREAD

config UART_SUPPORT_RX_THREAD_BUFFER_SIZE
    int
    prompt "UART RX thread heap size."
    default 8192
    depends on UART_SUPPORT_RX_THREAD

config UART_SUPPORT_RX_THREAD_PRIORITY
    int
    prompt "UART RX thread priority."
    default 1
    depends on UART_SUPPORT_RX_THREAD

config UART_SUPPORT_RX_THREAD_DEBUG
    bool
    prompt "UART support RX thread debug."
    default n
    depends on UART_SUPPORT_RX_THREAD

config UART_SUPPORT_DMA
    bool
    prompt "UART support dma."
    default y
    depends on DRIVER_SUPPORT_UART
    select DRIVER_SUPPORT_DMA

config UART_SUPPORT_SEND_IN_DMA_ISR
    bool
    prompt "UART Support send in dma isr"
    default n
    depends on DRIVER_SUPPORT_DMA

config UART_SUPPORT_INT_TRIGGER_DMA
    bool
    prompt "UART support rx interrupt trigger dma."
    default y
    depends on UART_SUPPORT_DMA

config UART_SUPPORT_DMA_LLI
    bool
    prompt "UART Support DMA lli transport."
    default n
    depends on UART_SUPPORT_DMA

config UART_LLI_BAUDRATE
    int
    prompt "UART LLI BAUDRATE. Depends on hardware constraints."
    range 115200 4000000
    default 115200
    depends on UART_SUPPORT_DMA_LLI

config UART_DMA_LLI_MAX_MEMBER
    int
    prompt "Max lli member number."
    default 6
    range 1 12
    depends on UART_SUPPORT_DMA_LLI

config UART_TX_DMA_NEED_HEADER
    bool
    prompt "Whether DMA TX need send head or not."
    default y
    depends on UART_SUPPORT_DMA_LLI

config UART_RX_DMA_NEED_HEADER
    bool
    prompt "Whether DMA RX need send head or not."
    default y
    depends on UART_SUPPORT_DMA_LLI

config UART_SUPPORT_FLOW_CTRL
    bool
    prompt "UART support flow control."
    default n
    depends on DRIVER_SUPPORT_UART

config UART_SUPPORT_HW_FLOW_CTRL
    bool
    prompt "UART support hardware flow control."
    default n
    depends on UART_SUPPORT_FLOW_CTRL

config UART_SUPPORT_SW_FLOW_CTRL
    bool
    prompt "UART support software flow control."
    default n
    depends on UART_SUPPORT_FLOW_CTRL

config UART_SUPPORT_LPM
    bool
    prompt "UART support low power mode, supend and reusme."
    default y
    depends on DRIVER_SUPPORT_UART

config UART_LOG_WRITE_WITH_NOLOCK
    bool
    prompt "UART support write logs with nolock."
    default y
    depends on DRIVER_SUPPORT_UART

config UART_FIFO_DEPTH
    int
    prompt "UART FIFO depth."
    range 64 128
    default 64
    depends on DRIVER_SUPPORT_UART

config UART_SUPPORT_LPC
    bool
    prompt "UART support low power control, control power and clock."
    default n
    depends on DRIVER_SUPPORT_UART

config UART_MULTI_CORE_RESUME
    bool
    prompt "UART support low power resume skip some port for multi-core."
    default n
    depends on UART_SUPPORT_LPM

config UART_NOT_SUPPORT_RX_CONDITON_SIZE_OPTIMIZE
    bool
    prompt "UART don't support rx condition size optimization."
    default n
    depends on UART_SUPPORT_RX

config UART_SUPPORT_RX_FRAME_CALLBACK
    bool
    prompt "UART support rx frame callback."
    default n
    depends on UART_NOT_SUPPORT_RX_CONDITON_SIZE_OPTIMIZE

config UART_SUPPORT_RX_FRAME_TIMER
    int
    prompt "UART support rx frame timer."
    default 1
    depends on UART_SUPPORT_RX_FRAME_CALLBACK

config UART_SUPPORT_QUERY_REGS
    bool
    prompt "UART support query regs values."
    default n
    depends on DRIVER_SUPPORT_UART

# 新增配置项，用于控制是否使用自定义的管脚配置文件
config USE_CUSTOM_PIN_CONFIG
    bool
    prompt "Use custom pin configuration file."
    default n

if USE_CUSTOM_PIN_CONFIG
    config UART_BUS0_TX_PIN
        int
        prompt "UART config uart BUS0 tx pin."
        default 19
        depends on DRIVER_SUPPORT_UART && (UART_BUS_MAX_NUM > 0)

    config UART_BUS0_RX_PIN
        int
        prompt "UART config uart BUS0 rx pin."
        default 20
        depends on DRIVER_SUPPORT_UART && (UART_BUS_MAX_NUM > 0)

    config UART_BUS0_CTS_PIN
        int
        prompt "UART config uart BUS0 cts pin, which is not used by default."
        default 100
        depends on UART_SUPPORT_FLOW_CTRL && (UART_BUS_MAX_NUM > 0)

    config UART_BUS0_RTS_PIN
        int
        prompt "UART config uart BUS0 rts pin, which is not used by default."
        default 100
        depends on UART_SUPPORT_FLOW_CTRL && (UART_BUS_MAX_NUM > 0)

    config UART_BUS1_TX_PIN
        int
        prompt "UART config uart BUS1 tx pin."
        default 17
        depends on DRIVER_SUPPORT_UART && (UART_BUS_MAX_NUM > 1)

    config UART_BUS1_RX_PIN
        int
        prompt "UART config uart BUS1 rx pin."
        default 18
        depends on DRIVER_SUPPORT_UART && (UART_BUS_MAX_NUM > 1)

    config UART_BUS1_CTS_PIN
        int
        prompt "UART config uart BUS1 cts pin, which is not used by default."
        default 100
        depends on UART_SUPPORT_FLOW_CTRL && (UART_BUS_MAX_NUM > 1)

    config UART_BUS1_RTS_PIN
        int
        prompt "UART config uart BUS1 rts pin, which is not used by default."
        default 100
        depends on UART_SUPPORT_FLOW_CTRL && (UART_BUS_MAX_NUM > 1)

    config UART_BUS2_TX_PIN
        int
        prompt "UART config uart BUS2 tx pin."
        default 15
        depends on DRIVER_SUPPORT_UART && (UART_BUS_MAX_NUM > 2)

    config UART_BUS2_RX_PIN
        int
        prompt "UART config uart BUS2 rx pin."
        default 16
        depends on DRIVER_SUPPORT_UART && (UART_BUS_MAX_NUM > 2)

    config UART_BUS2_CTS_PIN
        int
        prompt "UART config uart BUS2 cts pin, which is not used by default."
        default 100
        depends on UART_SUPPORT_FLOW_CTRL && (UART_BUS_MAX_NUM > 2)

    config UART_BUS2_RTS_PIN
        int
        prompt "UART config uart BUS2 rts pin, which is not used by default."
        default 100
        depends on UART_SUPPORT_FLOW_CTRL && (UART_BUS_MAX_NUM > 2)
endif

if !USE_CUSTOM_PIN_CONFIG
    config UART_L0_TX_PIN
        int
        prompt "UART config uart L0 tx pin."
        default 19
        depends on DRIVER_SUPPORT_UART

    config UART_L0_RX_PIN
        int
        prompt "UART config uart L0 rx pin."
        default 20
        depends on DRIVER_SUPPORT_UART

    config UART_L0_CTS_PIN
        int
        prompt "UART config uart L0 cts pin, which is not used by default."
        default 100
        depends on UART_SUPPORT_FLOW_CTRL

    config UART_L0_RTS_PIN
        int
        prompt "UART config uart L0 rts pin, which is not used by default."
        default 100
        depends on UART_SUPPORT_FLOW_CTRL

    config UART_H0_TX_PIN
        int
        prompt "UART config uart H0 tx pin."
        default 17
        depends on DRIVER_SUPPORT_UART

    config UART_H0_RX_PIN
        int
        prompt "UART config uart H0 rx pin."
        default 18
        depends on DRIVER_SUPPORT_UART

    config UART_H0_CTS_PIN
        int
        prompt "UART config uart H0 cts pin, which is not used by default."
        default 100
        depends on UART_SUPPORT_FLOW_CTRL

    config UART_H0_RTS_PIN
        int
        prompt "UART config uart H0 rts pin, which is not used by default."
        default 100
        depends on UART_SUPPORT_FLOW_CTRL

    config UART_L1_TX_PIN
        int
        prompt "UART config uart L1 tx pin."
        default 15
        depends on DRIVER_SUPPORT_UART

    config UART_L1_RX_PIN
        int
        prompt "UART config uart L1 rx pin."
        default 16
        depends on DRIVER_SUPPORT_UART

    config UART_L1_CTS_PIN
        int
        prompt "UART config uart L1 cts pin, which is not used by default."
        default 100
        depends on UART_SUPPORT_FLOW_CTRL

    config UART_L1_RTS_PIN
        int
        prompt "UART config uart L1 rts pin, which is not used by default."
        default 100
        depends on UART_SUPPORT_FLOW_CTRL
endif

config UART_SUPPORT_RECV_RAW_DATA
    bool
    prompt "UART support receive raw data"
    default n
    depends on UART_SUPPORT_DMA_LLI

config UART_FIFO_INT_RX_LEVEL
    int
    prompt "UART fifo int rx level"
    range 0 4
    default 2
    depends on UART_SUPPORT_DMA_LLI

config DMA_WAIT_UART_IDLE_INT_LEN
    int
    prompt "UART DMA reveive max length."
    range 0 4096
    default 1024
    depends on UART_SUPPORT_RECV_RAW_DATA

config UART_IDLE_PAYLOAD_LEN
    int
    prompt "UART IDLE reveive max length."
    range 0 256
    default 64
    depends on UART_SUPPORT_RECV_RAW_DATA
```

## src/drivers/drivers/hal/adc/Kconfig
```kconfig
#===============================================================================
# @brief    Kconfig file.
# Copyright (c) HiSilicon (Shanghai) Technologies Co., Ltd. 2023-2023. All rights reserved.
#===============================================================================
config ADC_USING_V151
    bool
    prompt "Using adc V151."
    default n
    depends on DRIVER_SUPPORT_ADC

config ADC_USING_V152
    bool
    prompt "Using adc V152."
    default y
    depends on DRIVER_SUPPORT_ADC

config ADC_USING_V153
    bool
    prompt "Using adc V153."
    default n
    depends on DRIVER_SUPPORT_ADC

config ADC_USING_V154
    bool
    prompt "Using adc V154."
    default n
    depends on DRIVER_SUPPORT_ADC

config ADC_USING_V155
    bool
    prompt "Using adc V155."
    default n
    depends on DRIVER_SUPPORT_ADC

config ADC_USING_V156
    bool
    prompt "Using adc V156."
    default n
    depends on DRIVER_SUPPORT_ADC

config ADC_USING_V157
    bool
    prompt "Using adc V157."
    default n
    depends on DRIVER_SUPPORT_ADC

config ADC_SUPPORT_AFE
    bool
    prompt "ADC use Analog front-end mode."
    default y
    depends on (ADC_USING_V152 || ADC_USING_V153 || ADC_USING_V157)

config ADC_SUPPORT_DIFFERENTIAL
    bool
    prompt "ADC support differential sample."
    default y
    depends on (ADC_USING_V153 || ADC_USING_V157)

config ADC_SUPPORT_AMIC
    bool
    prompt "Whether ADC support AMIC."
    default y
    depends on ADC_USING_V153

config ADC_SUPPORT_HAFE
    bool
    prompt "Whether ADC support HAFE."
    default y
    depends on ADC_USING_V152

config AFE_SAMPLE_TIMES
    int
    prompt "The numbers ADC sample to average."
    default 4
    depends on ADC_USING_V152

config ADC_SUPPORT_DIFFERENTIAL_SAMPLE
    bool
    prompt "ADC support differential sample for AFE."
    default y
    depends on (ADC_SUPPORT_DIFFERENTIAL && ADC_USING_V157)
```

## src/drivers/drivers/hal/can_fd/Kconfig
```kconfig
#===============================================================================
# @brief    Kconfig file.
# Copyright (c) HiSilicon (Shanghai) Technologies Co., Ltd. 2022-2022. All rights reserved.
#===============================================================================
config STANDARD_CAN_FILTER_NUM
    int
    prompt "Maximum number of standard CAN filter."
    range 0 128
    default 27
    depends on CAN_USE_V1_DRIVER

config EXTENDED_CAN_FILTER_NUM
    int
    prompt "Maximum number of extend CAN filter."
    range 0 64
    default 27
    depends on CAN_USE_V1_DRIVER

config CAN_TX_BUFFER_SIZE
    int
    prompt "Tx FIFO maximum size."
    range 0 32
    default 0
    depends on CAN_USE_V1_DRIVER

config CAN_RX_FIFO0_SIZE
    int
    prompt "Rx FIFO 0 maximum size."
    range 0 64
    default 0
    depends on CAN_USE_V1_DRIVER

config CAN_RX_FIFO1_SIZE
    int
    prompt "Rx FIFO 1 maximum size."
    range 0 64
    default 0
    depends on CAN_USE_V1_DRIVER
```

## src/drivers/drivers/hal/cpu_trace_v2/v100/Kconfig
```kconfig
#===============================================================================
# @brief    Kconfig file.
# Copyright (c) HiSilicon (Shanghai) Technologies Co., Ltd. 2024-2024. All rights reserved.
#===============================================================================
config CPUTRACE_HAL_V2
    bool
    prompt "CPU TRACE HAL V2 version."
    default n
    depends on DRIVER_SUPPORT_CPUTRACEV2
```

## src/drivers/drivers/hal/dma/Kconfig
```kconfig
#===============================================================================
# @brief    Kconfig file.
# Copyright (c) HiSilicon (Shanghai) Technologies Co., Ltd. 2022-2022. All rights reserved.
#===============================================================================
config DMA_USING_V100
    bool
    prompt "Using DMA V100."
    default y
    depends on DRIVER_SUPPORT_DMA

config DMA_USING_V120
    bool
    prompt "Using DMA V120."
    default y
    depends on DRIVER_SUPPORT_DMA

config DMA_USING_V151
    bool
    prompt "Using DMA V151."
    default n
    depends on DRIVER_SUPPORT_DMA

config DMA_SUPPORT_FIXED_CH
    bool
    prompt "Fixed DMA channel."
    default n
    depends on DMA_USING_V151

config DMA_TRANSFER_LOCK_BUS
    bool
    prompt "DMA transfer lock bus."
    default n
    depends on DMA_USING_V151

config DMA_USING_V151_V0
    int
    prompt "DMA transfer version 1.0."
    default 0
    depends on DMA_USING_V151

config DMA_USING_V151_V6
    int
    prompt "DMA transfer version 6.0. Supports non-aligned transmission, with a maximum transfer length of 16383 bytes."
    default 6
    depends on DMA_USING_V151

config DMA_USING_V151_V7
    int
    prompt "DMA transfer version 7.0. Supports a maximum of 10 transmission channels."
    default 7
    depends on DMA_USING_V151

config DMA_USING_V151_VID
    int
    prompt "DMA transfer version set."
    default 0
    depends on DMA_USING_V151

config DMA_SUPPORT_SMDMA
    bool
    prompt "DMA support SMDMA."
    default n
    depends on DRIVER_SUPPORT_DMA && (DMA_USING_V100 || DMA_USING_V151)

config SUPPORT_DATA_CACHE
    bool
    prompt "DMA support DATA CACHE."
    default n
    depends on DRIVER_SUPPORT_DMA

config DMA_LLI_NODE_FIX_MEM
    bool
    prompt "DMA lli node using static memory."
    default n
    depends on DRIVER_SUPPORT_DMA

config DMA_LLI_NODE_MAX
    int
    prompt "DMA lli node max count."
    default 4
    depends on DMA_LLI_NODE_FIX_MEM

config DMA_MEMORY_TRANS_PROT
    bool
    prompt "channel The DMA channel."
    default n
    depends on DRIVER_SUPPORT_DMA

config DMA_MAPPED_MEM
    bool
    prompt "support MAPPED MEM."
    default n
    depends on DRIVER_SUPPORT_DMA
```
