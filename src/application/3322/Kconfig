## src/drivers/drivers/hal/efuse/Kconfig
```kconfig
#===============================================================================
# @brief    Kconfig file.
# Copyright (c) HiSilicon (Shanghai) Technologies Co., Ltd. 2023-2023. All rights reserved.
#===============================================================================
config EFUSE_USING_V151
    bool
    prompt "Using EFUSE V151"
    default y
    depends on DRIVER_SUPPORT_EFUSE

config EFUSE_SWITCH_EN
    bool
    prompt "Using EFUSE SWITCH EN"
    default n
    depends on DRIVER_SUPPORT_EFUSE

config EFUSE_REGION_NUM
    int
    prompt "Max REGION of the EFUSE"
    range 1 3
    default 1
    depends on EFUSE_USING_V151

config EFUSE_READ_TO_RAM
    bool
    prompt "Using EFUSE READ TO RAM"
    default n
    depends on DRIVER_SUPPORT_EFUSE

config EFUSE_POWER_ON
    bool
    prompt "Using EFUSE POWER ON"
    default n
    depends on DRIVER_SUPPORT_EFUSE

config EFUSE_CONFIG_VOL
    bool
    prompt "Using EFUSE CONFIG VOL"
    default n
    depends on DRIVER_SUPPORT_EFUSE
```

## src/drivers/drivers/hal/pwm/Kconfig
```kconfig
#===============================================================================
# @brief    Kconfig file.
# Copyright (c) HiSilicon (Shanghai) Technologies Co., Ltd. 2022-2022. All rights reserved.
#===============================================================================
config PWM_USING_V150
    bool
    prompt "Using PWM V150."
    default n
    depends on DRIVER_SUPPORT_PWM

config PWM_USING_V151
    bool
    prompt "Using PWM V151."
    default n
    depends on DRIVER_SUPPORT_PWM

config PWM_USING_V152
    bool
    prompt "Using PWM V152."
    default n
    depends on DRIVER_SUPPORT_PWM

config PWM_PRELOAD
    bool
    prompt "Using PWM preload."
    default n
    depends on PWM_USING_V151 || PWM_USING_V152

config PWM_GROUP_NUM
    int
    prompt "The number of groups in PWM."
    range 1 16
    default 6
    depends on DRIVER_SUPPORT_PWM

config PWM_CHANNEL_NUM
    int
    prompt "PWM channel number."
    default 6
    depends on DRIVER_SUPPORT_PWM

config PWM_SUPPORT_TIME_32BIT
    bool
    prompt "Support time 32bit."
    default n
    depends on PWM_USING_V151 || PWM_USING_V152

config PWM_SUPPORT_CLOCK_ENABLE
    bool
    prompt "Support PWM clock enable."
    default n
    depends on PWM_USING_V151 || PWM_USING_V152

config PWM_PERIODLOAD_FLAG_BIT
    bool
    prompt "Support PWM periodload flag."
    default n
    depends on PWM_USING_V151

config PWM_IP_VERSION_V151_PRO
    bool
    prompt "The pwm ip version support seamless PWM waveform adjustment using DMA."
    default y
    depends on PWM_USING_V151 && DRIVER_SUPPORT_LPB
```

## src/drivers/drivers/hal/sfc_v2/Kconfig
```kconfig
#===============================================================================
# @brief    Kconfig file.
# Copyright (c) HiSilicon (Shanghai) Technologies Co., Ltd. 2024-2024. All rights reserved.
#===============================================================================
config SFC_DEBUG
    bool
    prompt "SFC Support DEBUG"
    default y
    depends on DRIVER_SUPPORT_SFC
```
