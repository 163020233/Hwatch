## src/drivers/drivers/driver/audio/source/drv/Kconfig
```kconfig
menu "Audio Driver Config"

menu "Audio Proc Info Config"

config PROC_SUPPORT
    bool "Audio Proc Info support"
    default y

if PROC_SUPPORT
###########################################################
choice
    prompt "Proc Type"
    default PROC_TYPE_DUMMY

config PROC_TYPE_DUMMY
    bool "dummy"
    help
        set proc type to dummy

config PROC_TYPE_REAL
    bool "real"
    help
        set proc type to real
endchoice

###########################################################
config PROC_OUTPUT_UART
    bool "enable proc uart output"
    default y
    depends on PROC_TYPE_DUMMY
    help
        enable proc output to uart

config PROC_OUTPUT_DIAG_SHELL
    bool "enable proc diag shell output"
    default n
    depends on PROC_TYPE_DUMMY
    help
        enable proc output to diag shell
###########################################################
config SYNC_STATUS_SUPPORT
    bool "show sync status in proc"
    default y

endif # PROC_SUPPORT
endmenu ## "Audio Proc Info Config"
###########################################################
menu "Audio Log Config"

config IPC_LOG_SUPPORT
    bool "DSP ipc log support"
    default y          if BRANDY || SOCMN1 || SOCMN2 || SW21 || 3322

config IPC_LOG_USE_DIAG_FRAME
    bool "DSP ipc log diag frame support"
    default y          if SW21 || 3322

config IPC_LOG_WITHOUT_HEADER
    bool "DSP ipc log without header support"
    default n

config DIAG_LOG_SUPPORT
    bool "APP Core Diag log support"
    default y          if BRANDY || SOCMN1 || SOCMN2

endmenu ## "Audio Log Config"
###########################################################
menu "Audio Debug Config"
config TIME_CONSUME
    bool "Audio api time consume support"
    default n

config DEBUG_MODULE_HANDLE
    bool "Show module handle in DSP log"
    default y if BRANDY || SW21 || 3322
    default n

config DEBUG_BASIC_STATUS_INFO
    bool "Show basic status info in DSP log"
    default y if SW21
    default n

config DEBUG_RUN_STATUS_INFO
    bool "Show run status info in DSP log"
    default y if SW21
    default n

config MEM_STATISTIC
    bool "DSP memory malloc statistic"
    default n

config MCPS_STATISTIC
    bool "DSP mcps statistic"
    default n

config MINIMIZE_SAMPLE_RELEASE
    bool "minimize sample release"
    default n
config REG_DFX_SAMPLE_SUPPORT
    bool "w4 and mem32 sample"
    default n
endmenu ## "Audio Debug Config"
###########################################################
menu "Audio DSP Firmware Config"
config FLASH_FIRMWARE_SUPPORT
    bool "flash firmware support"
    default n

config DSP_OVERLAY_SUPPORT
    bool "DSP Overlay Support"
    default y

choice
    prompt "Overlay Location"
    default DRV_OVERLAY_LOAD_FROM_FLASH
    depends on DSP_OVERLAY_SUPPORT

config DRV_OVERLAY_LOAD_FROM_FLASH
    bool "flash"
    help
        load overlay from flash

config DRV_OVERLAY_LOAD_FROM_FILE
    bool "file system"
    help
        load overlay from file system
endchoice

config DRV_OVERLAY_LOAD_FROM
    string
    default "flash"          if DRV_OVERLAY_LOAD_FROM_FLASH
    default "file"           if DRV_OVERLAY_LOAD_FROM_FILE

config FLASH_PARTITION_SUPPORT
    bool "Get firmware flash addr by partition interface"
    default n
###########################################################
config SIGN_SUPPORT
    bool "Audio Firmware Sign support"
    default n

if SIGN_SUPPORT
config SIGN_CHECK_ONLY_SUPPORT
    bool "Audio Firmware Check Sign Only support"
    default y          if SOCMN2
    default n

choice
    prompt "Sign Type"
    default SIGN_TYPE_CBG  if SW21
    default SIGN_TYPE_CFBB if SOCMN2

config SIGN_TYPE_CBG
    bool "cbg"
config SIGN_TYPE_CFBB
    bool "cfbb"
endchoice

config SIGN_TYPE
    string
    default "cbg"          if SIGN_TYPE_CBG
    default "cfbb"         if SIGN_TYPE_CFBB

config SIGN_HEADER_LEN
    hex "bin header signed info length(Bytes)"
    default 0x300

endif # SIGN_SUPPORT
###########################################################
endmenu ## "Audio DSP Firmware Config"
###########################################################
menu "Audio Module Config"
###########################################################
config DSP_I2C_SUPPORT
    bool "dsp i2c support"
    default n

config SHELL_SUPPORT
    bool "dsp shell support"
    default y

config WATCHDOG_SUPPORT
    bool "dsp watchdog support"
    default n

config EXCEPTION_TEST_SUPPORT
    bool "dsp exception test support"
    default n

config TEST_CORE_SUPPORT
    bool "dsp test cases support"
    default y

if TEST_CORE_SUPPORT
config AI_DFT_TEST_CORE_SUPPORT
    bool "ai dft test support"
    default n

config EDMA_DFT_TEST_CORE_SUPPORT
    bool "edma dft test support"
    default n

config SIO_DFT_TEST_CORE_SUPPORT
    bool "sio dft test support"
    default n

config IPC_TEST_CORE_SUPPORT
    bool "ipc test support"
    default n

config I2C_TEST_CORE_SUPPORT
    bool "i2c test support"
    default n
endif # TEST_CORE_SUPPORT
###########################################################
config DPM_SUPPORT
    bool "Data process module support"
    default n

config DPM_FIR_SUPPORT
    bool "Fir Data process module support"
    depends on DPM_SUPPORT
    default n

config ANC_SUPPORT
    bool "anc support"
    default n

config HAID_SUPPORT
    bool "hearing aid support"
    default n
    default y          if SOCMN1 || SOCMN2

config HAID_DMIC_SUPPORT
    bool "hearing aid through dmic support"
    depends on HAID_SUPPORT

config BINAURAL_SYNC_SUPPORT
    bool "binaural sync support"
    default n
    default y          if SOCMN1 || SOCMN2

config BT_MUSIC_SNK_LOW_LATENCY_SUPPORT
    bool "bt music sink low latency support"
    depends on BINAURAL_SYNC_SUPPORT
    default n

choice
    prompt "sync hal driver version"
    default SYNC_HAL_DALLAS_V100

config SYNC_HAL_DALLAS_V100
    bool "dallas_v100"
    help
        set sync hal driver version to v100

config SYNC_HAL_DALLAS_V400
    bool "dallas_v400"
    help
        set sync hal driver version to v400
endchoice

config SYNC_HAL_VERSION
    string
    default "dallas_v100"        if SYNC_HAL_DALLAS_V100
    default "dallas_v400"        if SYNC_HAL_DALLAS_V400

if SYNC_HAL_DALLAS_V400
choice
    prompt "sync toggle type"
    default SYNC_TOG_TYPE_SINGLE

config SYNC_TOG_TYPE_SINGLE
    bool "single toggle"
    help
        set sync toggle type to single toggle

config SYNC_TOG_TYPE_MULTI
    bool "multiple toggle"
    help
        set sync toggle type to multiple toggle
endchoice

config SYNC_TOG_TYPE
    string
    default "single_tog"        if SYNC_TOG_TYPE_SINGLE
    default "multi_tog"         if SYNC_TOG_TYPE_MULTI
endif # SYNC_HAL_DALLAS_V400

config HW_REF_SUPPORT
    bool "hardware ref support"
    default n
    default y          if SOCMN2

config BT_MUSIC_SEND_MUTE_PACKET_SUPPORT
    bool "send mute packet in bt music scene support"
    default n

config BT_MUSIC_FLOW_CTRL_SUPPORT
    bool "Flow control for bt source music scene support"
    default n

config BT_MUSIC_OFFLOAD_SUPPORT
    bool "adaptation for bt music offload changes support"
    default n

config LOWPOWER_MSG_SUPPORT
    bool "lower power message support"
    default n
    default y          if SOCMN1 || SOCMN2

config ASR_SUPPORT
    bool "asr support"
    default n
    default y          if 3322

config TTS_SUPPORT
    bool "tts support"
    default n
    default y          if 3322

config EFFECT_ADJUSTMENT_SUPPORT
    bool "effect adjustment support"
    default n
    default y          if 3322

if SOCMN1 || SOCMN2
config LIVE_MIC_SUPPORT
    bool "live mic support"
    default n
endif # SOCMN1 || SOCMN2

config BMIC_UAC_8_CHANNELS_SUPPORT
    bool "bmic uac 8 channels support"
    default n
    depends on LIVE_MIC_SUPPORT

config AUDIO_SPEED_SUPPORT
    bool "audio speed support"
    default n
config AENC_OUT_AFULL_EVENT_SUPPORT
    bool "aenc output buffer almost full event support"
    default n
config ADEC_PSS_SUPPORT
    bool "get adec play stream size support"
    default n

config MUTE_DETECT_SUPPORT
    bool "mute detect support"
    default n

config MUTE_DETECT_CLAMP_NOISE_SUPPORT
    bool "mute detect clamp noise support"
    default n
    depends on MUTE_DETECT_SUPPORT

config NATURE_DSP_SIGNAL_SUPPORT
    bool "Nature DSP Signal and VFPU Library support"
    default n
    default y          if SW21
###########################################################
config SUPPORT_RT_SMALL_MEM
    bool "rt-thread small mem support"
    default n
###########################################################
choice
    prompt "ipc driver version"
    default IPC_DRV_VERSION_V0 if BRANDY || SOCMN1
    default IPC_DRV_VERSION_V1

config IPC_DRV_VERSION_V0
    bool "ipc_v0"
    help
        set ipc driver version to v0

config IPC_DRV_VERSION_V1
    bool "ipc_v1"
    help
        set ipc driver version to v1
endchoice

config IPC_DRV_VERSION
    string
    default "ipc_v0"        if IPC_DRV_VERSION_V0
    default "ipc_v1"        if IPC_DRV_VERSION_V1
###########################################################
endmenu ## "Audio Module Config"
###########################################################
###########################################################
menu "NPU Support Config"
config NPU_SUPPORT
    bool "NPU Support"
    default n

if NPU_SUPPORT
config NPU_LIB_TYPE
    string "NPU Library Type"
    default "release"

endif # NPU_SUPPORT

endmenu # NPU Support Config
###########################################################
source "drv/vendor/Kconfig"
###########################################################
endmenu ## "Audio Driver Config"
```

## src/drivers/drivers/driver/audio/source/drv/vendor/Kconfig
```kconfig
menu "Audio Vendor Driver Config"

config VENDOR_DRIVER_SUPPORT
    bool "Vendor Driver Support"
    default y          if BRANDY
    default n

if VENDOR_DRIVER_SUPPORT
###########################################################
menu "ANC CODEC Driver"

config VENDOR_DRIVER_ANC_CODEC_SUPPORT
    bool "ANC CODEC support"
    default n

if VENDOR_DRIVER_ANC_CODEC_SUPPORT

config CONTROL_ANC_CODEC_IN_ACORE
    bool "control anc codec via A core"
    default y

config CONTROL_ANC_CODEC_IN_DSP
    bool "control anc codec via DSP"
    default n

config ANC_CODEC_I2C_BUS_ID
    int "anc codec i2c bus id"
    default 0

config ANC_CODEC_I2C_ADDR
    hex "anc codec i2c address"
    default 0x28

endif

endmenu ## "ANC CODEC Driver"

menu "aw85825 Driver"

config VENDOR_DRIVER_AW85825_SUPPORT
    bool "aw85825 support"
    default n

endmenu ## "aw85825 Driver"

menu "acm8623 Driver"

config VENDOR_DRIVER_ACM8623_SUPPORT
    bool "acm8623 support"
    default n

if VENDOR_DRIVER_ACM8623_SUPPORT

config ACM8623_PBTL_MODE_ENABLE
    bool "enable acm8623 PBTL mode"
    default y

endif

endmenu ## "acm8623 Driver"

menu "acm8625s Driver"

config VENDOR_DRIVER_ACM8625S_SUPPORT
    bool "acm8625s support"
    default n

endmenu ## "acm8625s Driver"

menu "acm8815 Driver"

config VENDOR_DRIVER_ACM8815_SUPPORT
    bool "acm8815 support"
    default n

endmenu ## "acm8815 Driver"

###########################################################
menu "aw88262 Driver"

config VENDOR_DRIVER_AW88262_SUPPORT
    bool "aw88262 support"
    default n

endmenu ## "aw88262 Driver"
###########################################################
menu "aw88166 Driver"

config VENDOR_DRIVER_AW88166_SUPPORT
    bool "aw88166 support"
    default n

if VENDOR_DRIVER_AW88166_SUPPORT

config CONTROL_AW88166_IN_ACORE
    bool "control aw88166 via A core"
    default y

config CONTROL_AW88166_IN_DSP
    bool "control aw88166 via DSP"
    default n

config AW88166_I2C_BUS_ID
    int "aw88166 i2c bus id"
    default 0

config AW88166_I2C_ADDR
    hex "aw88166 i2c address"
    default 0x34

endif

endmenu ## "aw88166 Driver"
###########################################################
menu "es8156 Driver"

config VENDOR_DRIVER_ES8156_SUPPORT
    bool "es8156 support"
    default n

if VENDOR_DRIVER_ES8156_SUPPORT

config CONTROL_ES8156_IN_ACORE
    bool "control es8156 via A core"
    default y

config CONTROL_ES8156_IN_DSP
    bool "control es8156 via DSP"
    default n

config ES8156_I2C_BUS_ID
    int "es8156 i2c bus id"
    default 0

config ES8156_I2C_ADDR
    hex "es8156 i2c address"
    default 0x28

endif

endmenu ## "es8156 Driver"
###########################################################
menu "es8311 Driver"

config VENDOR_DRIVER_ES8311_SUPPORT
    bool "es8311 support"
    default n

if VENDOR_DRIVER_ES8311_SUPPORT

config CONTROL_ES8311_IN_ACORE
    bool "control es8311 via A core"
    default y

config CONTROL_ES8311_IN_DSP
    bool "control es8311 via DSP"
    default n

config ES8311_I2C_BUS_ID
    int "es8311 i2c bus id"
    default 0

config ES8311_I2C_ADDR
    hex "es8311 i2c address"
    default 0x28

endif

endmenu ## "es8311 Driver"
###########################################################
menu "es8396 Driver"

config VENDOR_DRIVER_ES8396_SUPPORT
    bool "es8396 support"
    default n

if VENDOR_DRIVER_ES8396_SUPPORT

config CONTROL_ES8396_IN_ACORE
    bool "control es8396 via A core"
    default y

config CONTROL_ES8396_IN_DSP
    bool "control es8396 via DSP"
    default n

config ES8396_I2C_BUS_ID
    int "es8396 i2c bus id"
    default 0

config ES8396_I2C_ADDR
    hex "es8396 i2c address"
    default 0x28

endif

endmenu ## "es8396 Driver"
###########################################################
endif ## VENDOR_DRIVER_SUPPORT
endmenu ## "Audio Vendor Driver Config"
```

## src/drivers/drivers/driver/can_fd/Kconfig
```kconfig
#===============================================================================
# @brief    Kconfig file.
# Copyright (c) HiSilicon (Shanghai) Technologies Co., Ltd. 2022-2022. All rights reserved.
#===============================================================================
config CAN_BUS_NUM
    int
    prompt "Number of CAN controller bus"
    range 1 3
    default 1
    depends on DRIVER_SUPPORT_CAN_FD

choice
    prompt "Choose CAN driver"
    default CAN_USE_V1_DRIVER

config CAN_USE_V1_DRIVER
    bool "CAN use V1 driver"
    depends on DRIVER_SUPPORT_CAN_FD
    help
        This option enables the use of the CAN V1 driver.
        This driver provides a lower-level interface for CAN communication.
        It is not recommended for general use and should only be selected
        if you have specific requirements that cannot be met by the standard
        AUTOSAR driver.

config CAN_USE_V2_DRIVER
    bool "CAN use V2 driver"
    depends on DRIVER_SUPPORT_CAN_FD
    help
        Enable the CAN V2 driver which introduces new callback functions for transmission and reception,
        aligning more closely with AUTOSAR interface logic.
        This driver version supports enhanced communication features and improves compatibility with AUTOSAR standards.
endchoice

config CAN_SUPPORT_TTCAN
    bool "CAN Support TTCAN"
    default false
    depends on CAN_USE_V2_DRIVER
```

## src/drivers/drivers/driver/cpu_trace_v2/Kconfig
```kconfig
#===============================================================================
# @brief    Kconfig file.
# Copyright (c) HiSilicon (Shanghai) Technologies Co., Ltd. 2024-2024. All rights reserved.
#===============================================================================
config CPUTRACE_V2
    bool
    prompt "CPU TRACE V2 version."
    default n
    depends on DRIVER_SUPPORT_CPUTRACEV2
config CPU_TRACE_MEM_REGION_LENGTH
    int
    prompt "Maximum memory size for CPU trace. Unit: byte."
    default 0x2100
    depends on DRIVER_SUPPORT_CPUTRACEV2
config CPU_TRACE_SUPPORT_LPM
    bool
    prompt "CPUTRACE Support low power mode, enter sleep."
    default n
    depends on DRIVER_SUPPORT_CPUTRACEV2
```
